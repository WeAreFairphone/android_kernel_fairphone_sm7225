## drivers/platform/fairphone/Kconfig
```kconfig
# Fairphone configuration options

config MACH_FAIRPHONE
	bool "Fairphone device"
	depends on ARCH_QCOM
	help
	  Support for Fairphone products

config MACH_FAIRPHONE_LAGOON
	bool "Fairphone lagoon"
	depends on ARCH_LAGOON
	select MACH_FAIRPHONE
	help
	  Support for Fairphone lagoon devices

menu "Fairphone board selection"

config MACH_FAIRPHONE_FP4
	bool "Fairphone 4 board"
	select MACH_FAIRPHONE_LAGOON
	help
	  Support for Fairphone 4

endmenu
```

## drivers/usb/pd/Kconfig
```kconfig
# SPDX-License-Identifier: GPL-2.0-only
#
# USB Power Delivery driver configuration
#
menu "USB Power Delivery"

config USB_PD
	def_bool n

config USB_PD_POLICY
	tristate "USB Power Delivery Protocol and Policy Engine"
	depends on EXTCON
	depends on TYPEC
	select USB_PD
	help
          Say Y here to enable USB PD protocol and policy engine.
	  This driver provides a class that implements the upper
	  layers of the USB Power Delivery stack. It requires a
	  PD PHY driver in order to transmit and receive PD
	  messages on its behalf.

config QPNP_USB_PDPHY
	tristate "QPNP USB Power Delivery PHY"
	depends on SPMI
	help
          Say Y here to enable QPNP USB PD PHY peripheral driver
	  which communicates over the SPMI bus.
	  The is used to handle the PHY layer communication of the
	  Power Delivery stack.

# Jin.wang added here to enable different usbpd logs level
config USB_PD_LOG_LVL
	int "USBPD Log level(0,3)"
	range 0 3
	default 1
	help
          enable different log level for usbpd debug. 0 for no logs,
          1 for error logs only, 2 for debug logs only(no error log),
          3 for all logs.
# Jin.wang added done.

endmenu
```
