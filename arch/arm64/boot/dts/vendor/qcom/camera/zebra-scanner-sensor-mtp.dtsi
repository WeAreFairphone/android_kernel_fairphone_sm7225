/* Copyright (C) 2021 Tcl Corporation Limited */

&qupv3_se7_i2c{
    status = "ok";
    qcom,clk-freq-out = <100000>;

	zebra,scan-sensor@5c{
		cell-index = <1>;
		compatible = "zebra,se47xx";
		reg = <0x5c>;
		csiphy-sd-index = <1>;
		sensor-position-roll = <90>;
		sensor-position-pitch = <0>;
		sensor-position-yaw = <180>;
		cam_vana-supply = <&L11A>;
		cam_clk-supply = <&cam_cc_titan_top_gdsc>;
		regulator-names = "cam_vana", "cam_clk";
		rgltr-cntrl-support;
		pwm-switch;
		rgltr-min-voltage = <1800000 0>;
		rgltr-max-voltage = <1800000 0>;
		rgltr-load-current = <0 0>;
		gpio-no-mux = <0>;
		pinctrl-names = "cam_default", "cam_suspend";
		pinctrl-0 = <&cam_sensor_mclk1_active
				&cam_sensor_active_rear_aux2>;
		pinctrl-1 = <&cam_sensor_mclk1_suspend
				&cam_sensor_suspend_rear_aux2>;
		gpios = <&tlmm 28 0>,
			<&tlmm 70 0>,
			<&tlmm 18 0>,
			<&tlmm 72 0>,
			<&tlmm 73 0>,
			<&tlmm 74 0>;
		gpio-reset = <1>;
		gpio-standby = <2>;
		gpio-custom1 = <3>;
		gpio-custom2 = <4>;
		gpio-custom3 = <5>;
		gpio-req-tbl-num = <0 1 2 3 4 5>;
		gpio-req-tbl-flags = <1 0 0 0 0 0>;
		gpio-req-tbl-label = "CAMIF_MCLK1",
					"SCAN_SHIFT",
					"BOOST_5V",
					"SCAN_VCC_ILLUM",
					"SCAN_VCC",
					"SCAN_SHIFT_ENABLE";
		sensor-mode = <0>;
		cci-device = <0>;
		cci-master = <1>;
		status = "disabled";
		clocks = <&camcc CAM_CC_MCLK1_CLK>;
		clock-names = "cam_clk";
		clock-cntl-level = "turbo";
		clock-rates = <24000000>;
	};
};

