// build   : 06-30-2021 15:30
// workbook: v1.18
// panel   : dsi-panel-hx83112a-auo-1080p-video
// cfg     : t2m_v1
&soc {
pxlw {
mdss_iris_cfg_hx83112a_auo_fhd_60fps_video: pxlw,mdss_iris_cfg_hx83112a_auo_fhd_60fps_video {
pxlw,platform = <1>;
pxlw,panel-type = "PANEL_OLED";
/*low power control: dynamic power gating, ulps low power, analog bypass */
pxlw,low-power = [00 00 01];
/*light up path, pq update path, single-ipopt path, 0-dsi, 1-i2c */
pxlw,path-sel = [00 00 00];
pxlw,chip-ver = <0x6936>;
pxlw,iris-chip-enable;
pxlw,iris-soft-disable;
pxlw,iris-default-mode-pt;
pxlw,pkt-payload-size = <228>;
pxlw,last-per-pkt = <1>;
pxlw,min-color-temp = <2500>;
pxlw,max-color-temp = <10000>;
pxlw,vivid-color-temp = <6500>;
pxlw,P3-color-temp = <7500>;
pxlw,sRGB-color-temp = <7500>;
pxlw,hdr-color-temp = <7500>;
//pxlw,virtual-channel-enable;
pxlw,virtual-channel-id = [00 02 03];
pxlw,dsi-embedded-enable = [00 02];
pxlw,non-embedded-mode-transfer-length = <0x0 0x400>;
pxlw,dpp-only-enable = <0>;
pxlw,qsync-mode = <0>;
pxlw,esd-ctrl = <0>;
pxlw,iris-lightup-sequence-pre = [
/*mipi rx*/
01  f1  00
];
pxlw,iris-lightup-sequence-pre0 = [
/*sys*/
00  a0  00
00  00  00
00  07  00
];
pxlw,iris-lightup-sequence-pre1 = [
/*sys*/
00  a0  00
00  00  00
00  07  00
];

pxlw,iris-lightup-sequence = [
/* rx ctrl */
01  f0  01
/* tx */
02  01  01
02  00  00
/* mipi dma */
01  e0  01
01  e3  01
/* dtg */
05  00  01
05  f0  01
/* dma */
11  e1  00
/* lut table */
80  00  01
80  01  01
80  f1  01
84  00  01
84  10  01
84  20  01
84  30  01
85  00  01
85  01  01
85  02  01
85  03  01
85  04  01
85  05  01
86  00  01
86  11  01
86  20  01
86  30  01
86  40  01
86  50  01
86  60  01
86  70  01
/* dbc */
0f  f0  01
0f  00  01
0f  fc  01
/* blc_pwm */
06  f0  01
06  00  01
/* scaler1d */
0b  f0  01
/* dport */
04  f0  01
04  80  01
/* pwil */
03  f0  01
03  d0  01
03  80  01
03  fc  01
03  51  01
/*3d-lut, 17*/
81  00  01
81  01  01
81  02  01
81  03  01
81  04  01
81  05  01
/*gamma,65-bin*/
83  00  01
/*dpp dither*/
89  00  01
/*dpp*/
0e  00  01
0e  10  01
0e  20  01
0e  30  01
0e  51  01
0e  52  01
0e  53  01
0e  50  01
0e  70  01
0e  60  01
0e  61  01
0e  62  01
0e  63  01
0e  54  01
0e  21  01
0e  22  01
0e  40  01
0e  31  01
0e  23  01
0e  32  01
0e  33  01
0e  a0  01
0e  72  01
0e  80  01
/*hdr_v2*/
09  00  01
09  10  01
09  20  01
09  30  01
09  40  01
09  50  01
09  60  01
09  70  01
09  90  01
09  a0  01
09  b0  01
09  c0  01
0a  00  01
0a  10  01
09  d0  01
09  80  01
/* dma */
11  f0  00
];

pxlw,iris-pq-default-val = [
/* pwil */
03  fc
/* dport */
04  f0
/* dbc PQ */
0f  00
0f  10
0f  fc
/* dbc lut */
80  00
80  01
80  f1
/* blc_pwm */
06  00
/* scaler1d */
84  00
84  10
84  20
84  30
/* hdr col */
86  00
86  11
86  20
86  30
86  40
86  50
86  60
86  70
/*dpp*/
0e  00
0e  01
0e  20
0e  30
0e  51
0e  52
0e  50
0e  70
0e  60
0e  61
0e  62
0e  63
0e  54
0e  40
0e  71
81  00
83  00
83  10
83  20
/* hdr */
09  00
09  10
09  20
09  30
09  40
09  50
09  60
09  70
09  90
09  a0
09  b0
09  c0
09  d0
0a  00
0a  10
];

pxlw,iris-cmd-list =
<

// mipi_rx: dphy
0x29 0x01 0x00 0x01 0x01F1 0x013 0xFFFFFFF4
0xF1100808 0x0D020200 0xF1100818 0x00000006 0xF1100A00 0x0000C960
0xF1100A08 0x000002F7 0xF1100A14 0x000002F7 0xF1100A1C 0x000002F7
0xF1100A24 0x000002F7 0xF1100A2C 0x000002F7 0xF1100800 0x00001200

// mipi_rx: ctrl
0x29 0x01 0x00 0x01 0x00F0 0x013 0xFFFFFFF4
0xF110001C 0x00000000 0xF1100080 0x00000100 0xF1100104 0x00000000
0xF1100144 0x0048021C 0xF1100148 0x0000021C 0xF1100238 0x00770000
0xF1100300 0x04370000 0xF1100304 0x09230000 0xF1101804 0x00000924

// mipi: man bypass ctrl
0x29 0x01 0x00 0x01 0x00D0 0x003 0xFFFFFFF4
0xF140001C 0xC988BC71

// mipi: abyp 0
0x29 0x00 0x00 0x01 0x00E0 0x021 0x0000000C 0xF1091800
0x0D020200 0x00000006 0x0000C960 0x0000022F 0x00000000 0x00000100
0x00000000 0x0048021C 0x0000021C 0x00770000 0x04370000 0x09230000
0x00000924 0x00004960 0x00410304 0x00000570 0xC200C039 0x08200438
0x0048021C 0x0000021C 0x04370000 0x09230000 0x00210011 0xC988BC71
0x3D030007 0x250A2409 0x25092109 0x0000C018 0x00000000 0x0000080C
0x00003E39

// mipi: abyp 1
0x29 0x01 0x00 0x01 0x00E0 0x008 0x0000000C 0xF1091C7C
0x000002F7 0x000002F7 0x000002F7 0x000002F7 0x000002F7 0x00001200

// mipi: man bypass ctrl dma
0x29 0x01 0x00 0x01 0x00E2 0x003 0x0000000C 0xF109185C
0xC988BC71

// mipi: misc
0x29 0x01 0x00 0x01 0x00E3 0x007 0xFFFFFFF4
0xF1090600 0x00000001 0xF1090794 0x00000000 0xF10914C0 0x00000040

// mipi: bitmask pb req
0x29 0x01 0x00 0x01 0x00E4 0x003 0xFFFFFFF4
0xF1100050 0x00000000

// mipi: abyp sys dpg
0x29 0x01 0x00 0x01 0x00E5 0x003 0x0000000C 0xF1091878
0x00003E39

// sys: a0: init 0
0x29 0x01 0x64 0x00 0x00A0 0x013 0xFFFFFFF4
0xF0000028 0x00000000 0xF0010040 0x00000008 0xF0000000 0x00000000
0xF0000004 0x000A80B2 0xF0000008 0x0000F018 0xF000002C 0x00008420
0xF0010040 0x0000000A 0xF0000028 0x000004D8 0xF0010040 0x00000008

// sys: misc
0x29 0x01 0x00 0x00 0x0000 0x013 0xFFFFFFF4
0xF000003C 0x00000003 0xF0000040 0x0000004F 0xF0000050 0x000001FD
0xF000005C 0x0000080C 0xF0000058 0x00000008 0xF0000080 0x0000004E
0xF00000E0 0x10000001 0xF00000E4 0x0000C400 0xF0010004 0x0090A01A

// sys: abyp: enter
0x29 0x01 0x00 0x00 0x0004 0x005 0xFFFFFFF4
0xF00000EC 0x00000002 0xF00000EC 0x00000000

// sys: abyp: exit
0x29 0x01 0x00 0x00 0x0105 0x005 0xFFFFFFF4
0xF00000EC 0x00000001 0xF00000EC 0x00000000

// sys: mpg off
0x29 0x01 0x00 0x00 0x0006 0x003 0xFFFFFFF4
0xF000003C 0x00000003

// sys: dma ctrl
0x29 0x01 0x00 0x00 0x0007 0x003 0xFFFFFFF4
0xF000007C 0x00000100

// sys: dpg event off
0x29 0x01 0x00 0x00 0x0010 0x003 0xFFFFFFF4
0xF0000038 0x00003E3F

// sys: dpg event on
0x29 0x01 0x00 0x00 0x0011 0x003 0xFFFFFFF4
0xF0000038 0x00003F39

// sys: dma0 one time trig
0x29 0x01 0x00 0x00 0x0020 0x005 0xFFFFFFF4
0xF000005C 0x0000082C 0xF000005C 0x0000080C

// sys: bitmask dpg ctrl
0x29 0x01 0x00 0x00 0x00F0 0x003 0xFFFFFFF4
0xF0000038 0x00003E39

// sys: bitmask mpg ctrl
0x29 0x01 0x00 0x00 0x00F1 0x003 0xFFFFFFF4
0xF000003C 0x00000007

// sys: bitmask abp ctrl
0x29 0x01 0x00 0x00 0x00F2 0x003 0xFFFFFFF4
0xF0010004 0x0090A01A

// sys: bitmask ulps ctrl
0x29 0x01 0x00 0x00 0x00F3 0x003 0xFFFFFFF4
0xF0000080 0x0000004E

// sys: bitmask alt_ctrl0
0x29 0x01 0x00 0x00 0x00F4 0x003 0xFFFFFFF4
0xF00000E0 0x10200001

// sys: bitmask pmu ctrl
0x29 0x01 0x00 0x00 0x00F5 0x003 0xFFFFFFF4
0xF0000040 0x0000004F

// sys: bitmask dma trig gen ctrl
0x29 0x01 0x00 0x00 0x00F6 0x003 0xFFFFFFF4
0xF000005C 0x0000080C

// sys: bitmask alt_ctrl1
0x29 0x01 0x00 0x00 0x00F7 0x003 0xFFFFFFF4
0xF00000E4 0x0000C400

// dtg: ctrl
0x29 0x01 0x00 0x05 0x0000 0x016 0x00000000 0xF10C0000
0x00000008 0x00000008 0x00000438 0x0000001C 0x00000005 0x00000005
0x00000924 0x0000001B 0x01010143 0x00001296 0x00000000 0x00000000
0x00000008 0x000041CE 0x00002BE8 0x00298039 0x00000001 0x00000001
0x00000001 0x00001F40

// dtg: update
0x29 0x01 0x00 0x05 0x00F0 0x003 0xFFFFFFF4
0xF10D0000 0x00000001

// mipi_tx: ctrl
0x29 0x01 0x00 0x02 0x0000 0x019 0xFFFFFFF4
0xF1400000 0xC200C039 0xF1400004 0x08200438 0xF1400008 0x0048021C
0xF140000C 0x0000021C 0xF1400010 0x04370000 0xF1400014 0x09230000
0xF1400018 0x00210011 0xF140001C 0xC988BC71 0xF1400040 0x3D030007
0xF1400044 0x250A2409 0xF1400048 0x25092109 0xF140004C 0x0000C018

// mipi_tx: dphy
0x29 0x01 0x00 0x02 0x0001 0x007 0xFFFFFFF4
0xF1440200 0x00004960 0xF1440004 0x00410304 0xF1440210 0x00000570

// dport: init
0x29 0x01 0x00 0x04 0x00F0 0x009 0x0000000C 0xF1090688
0x00004007 0x49240438 0x21008801 0x46000800 0x06001805 0x082C0100
0x00000000

// dport: update
0x29 0x01 0x00 0x04 0x0080 0x003 0x0000000C 0xF10906A0
0x00000001

// pwil: ctrl
0x29 0x01 0x00 0x03 0x00F0 0x022 0x0000000C 0xF1090604
0x02801104 0x00080008 0x00000040 0x09240438 0xE4100010 0x00000888
0x00000000 0x09240438 0x09240438 0xE4100020 0x00000888 0x00000000
0x07800438 0x07800438 0x00000000 0x021C021C 0x00900240 0x00000001
0x0000001D 0x0951094E 0x7FFE094E 0x10E47E4C 0x7BBD0E56 0x00000000
0x00000000 0x00000000 0x00000000 0x09BA3C00 0xFFFFFFFF 0x00000040
0x09230000 0x04370000

// pwil: update
0x29 0x01 0x00 0x03 0x0080 0x003 0x0000000C 0xF1090684
0x00000100

// pwil: capen 0
0x29 0x01 0x00 0x03 0x0050 0x003 0xFFFFFFF4
0xF1140044 0x00000000

// pwil: capen 1
0x29 0x01 0x00 0x03 0x0051 0x003 0x0000000C 0xF10914C4
0x00000001

// pwil: capen 0 (dma)
0x29 0x01 0x00 0x03 0x0052 0x003 0x0000000C 0xF10914C4
0x00000000

// pwil: bitmask: data path
0x29 0x01 0x00 0x03 0x00FC 0x003 0x0000000C 0xF1090608
0x00080008

// pwil: bitmask: data path1
0x29 0x01 0x00 0x03 0x00FD 0x003 0x0000000C 0xF109060C
0x00000040

// pwil: sw_clean_path
0x29 0x01 0x00 0x03 0x00D0 0x004 0x0000000C 0xF1091C94
0x02801904 0x02801104

// dpp: init
0x29 0x01 0x00 0x0E 0x00F0 0x042 0x0000000C 0xF10914C8
0x00210043 0x00004055 0x00000240 0x00000010 0x00000000 0x00000000
0x00000000 0x45104510 0x45104510 0x40004000 0x40004000 0x00040C00
0x00400020 0xB29500A0 0x80808080 0x00000002 0x00000028 0x40004000
0x00004000 0x00800040 0x0708021C 0x3FFFFFFF 0x00000000 0x00780050
0x00780050 0x00008000 0x00400003 0x0760C00B 0x21F5B0DF 0x000FFEFB
0x17F3FC7F 0x2FF9FDFF 0x000FFF7F 0x0154AC55 0x00000006 0x60402000
0xDFBF9F80 0x000000FF 0x18040080 0x300A0200 0x00000011 0x08000000
0x00000000 0x08000000 0x00000800 0x00000000 0x00000000 0x00000000
0x00000000 0x00000000 0x17F3FC7F 0x2FF9FDFF 0x000FFF7F 0x08000000
0x00000000 0x08000000 0x00000800 0x00000000 0x08000000 0x00000000
0x08000000 0x00000800 0x00000000 0x00000800

// dpp: gamma LUT
0x29 0x01 0x00 0x0E 0x00FE 0x002 0x0000000C 0xF10915C8


// dpp: dither LUT
0x29 0x01 0x00 0x0E 0x00F8 0x002 0x0000000C 0xF109187C


// dpp: CLT_EN
0x29 0x01 0x00 0x0E 0x0000 0x003 0x0000000C 0xF10914C8
0x00210043

// dpp: bitmask: path ctrl
0x29 0x01 0x00 0x0E 0x0010 0x003 0x0000000C 0xF10914CC
0x00004055

// dpp: bitmask: gamma mode
0x29 0x01 0x00 0x0E 0x0020 0x003 0x0000000C 0xF10914D0
0x00000240

// dpp: csc2 ctrl
0x29 0x01 0x00 0x0E 0x0030 0x006 0x0000000C 0xF10914D4
0x00000010 0x00000000 0x00000000 0x00000000

// dpp: lut interp
0x29 0x01 0x00 0x0E 0x0051 0x004 0x0000000C 0xF10914E4
0x45104510 0x45104510

// dpp: lut gain
0x29 0x01 0x00 0x0E 0x0052 0x003 0x0000000C 0xF10914EC
0x40004000

// dpp: lut gain2
0x29 0x01 0x00 0x0E 0x0053 0x004 0x0000000C 0xF10914F0
0x40004000 0x00040C00

// dpp: lut ctrl
0x29 0x01 0x00 0x0E 0x0050 0x003 0x0000000C 0xF10914F8
0x00400020

// dpp: s curve 0
0x29 0x01 0x00 0x0E 0x0070 0x005 0x0000000C 0xF10914FC
0xB29500A0 0x80808080 0x00000002

// dpp: FD
0x29 0x01 0x00 0x0E 0x0060 0x003 0x0000000C 0xF1091508
0x00000028

// dpp: DIMM
0x29 0x01 0x00 0x0E 0x0061 0x004 0x0000000C 0xF109150C
0x40004000 0x00004000

// dpp: FD shape
0x29 0x01 0x00 0x0E 0x0062 0x005 0x0000000C 0xF1091514
0x00800040 0x0708021C 0x3FFFFFFF

// dpp: demo win
0x29 0x01 0x00 0x0E 0x0063 0x005 0x0000000C 0xF1091520
0x00000000 0x00780050 0x00780050

// dpp: FADE
0x29 0x01 0x00 0x0E 0x0054 0x003 0x0000000C 0xF109152C
0x00008000

// dpp: APL ctrl
0x29 0x01 0x00 0x0E 0x0021 0x003 0x0000000C 0xF1091530
0x00400003

// dpp: APL ctrl 2
0x29 0x01 0x00 0x0E 0x0022 0x00F 0x0000000C 0xF1091534
0x0760C00B 0x21F5B0DF 0x000FFEFB 0x17F3FC7F 0x2FF9FDFF 0x000FFF7F
0x0154AC55 0x00000006 0x60402000 0xDFBF9F80 0x000000FF 0x18040080
0x300A0200

// dpp: csc cm
0x29 0x01 0x00 0x0E 0x0040 0x00B 0x0000000C 0xF1091568
0x00000011 0x08000000 0x00000000 0x08000000 0x00000800 0x00000000
0x00000000 0x00000000 0x00000000

// dpp: csc2 crstk cctrl
0x29 0x01 0x00 0x0E 0x0031 0x003 0x0000000C 0xF109158C
0x00000000

// dpp: csc2 apl
0x29 0x01 0x00 0x0E 0x0023 0x005 0x0000000C 0xF1091590
0x17F3FC7F 0x2FF9FDFF 0x000FFF7F

// dpp: csc2 crstk coef
0x29 0x01 0x00 0x0E 0x0032 0x00C 0x0000000C 0xF109159C
0x08000000 0x00000000 0x08000000 0x00000800 0x00000000 0x08000000
0x00000000 0x08000000 0x00000800 0x00000000

// dpp: csc2 coef
0x29 0x01 0x00 0x0E 0x0033 0x007 0x0000000C 0xF10917E8
0x08000000 0x00000000 0x08000000 0x00000800 0x00000000

// dpp: gc
0x29 0x01 0x00 0x0E 0x00A0 0x003 0x0000000C 0xF10915C4
0x00000800

// dpp: s curve 0
0x29 0x01 0x00 0x0E 0x0071 0x024 0x0000000C 0xF1091760
0x00800800 0x00800800 0x00800800 0x00800800 0x00800800 0x00800800
0x00800800 0x00800800 0x00800800 0x00800800 0x00800800 0x00800800
0x00800800 0x00800800 0x00800800 0x00800800 0x00000800 0x00800800
0x00800800 0x00800800 0x00800800 0x00800800 0x00800800 0x00800800
0x00800800 0x00800800 0x00800800 0x00800800 0x00800800 0x00800800
0x00800800 0x00800800 0x00800800 0x00000800

// dpp: s curve 1
0x29 0x01 0x00 0x0E 0x0072 0x024 0x0000000C 0xF1091760
0x00FFF800 0x00FFFFFF 0x00FFFFFF 0x00FFFFFF 0x00FFFFFF 0x00FFFFFF
0x00FFFFFF 0x00FFFFFF 0x00FFFFFF 0x00F11FD2 0x00DC5E63 0x00CAFD34
0x00BC5C35 0x00AFBB5C 0x00A4CAA1 0x009B39FD 0x0000096D 0x008EC92B
0x0087A8B1 0x00813845 0x007E37FF 0x007B17C9 0x0078979C 0x0076A778
0x0075375E 0x0074674C 0x00742743 0x00747743 0x0075574C 0x0076D75F
0x0079177D 0x007C17A7 0x008007DE 0x00000800

// dpp: s curve 2
0x29 0x01 0x00 0x0E 0x0073 0x024 0x0000000C 0xF1091760
0x003E0800 0x0050B490 0x005BA568 0x006375FB 0x0069C66C 0x006F46CD
0x0074271D 0x00784765 0x007C27A4 0x007FB7DE 0x00822810 0x00840831
0x0085784C 0x00868860 0x00876870 0x0088187C 0x00000885 0x0088A888
0x0088E88D 0x00890890 0x00890890 0x0088E88F 0x0088A88C 0x00885888
0x0087F882 0x0087687B 0x0086D872 0x0085285F 0x0083C846 0x0082B833
0x0081E824 0x00812818 0x0080080B 0x00000800

// dpp: update
0x29 0x01 0x00 0x0E 0x0080 0x003 0x0000000C 0xF10917FC
0x00000001

// dbc: init 0
0x29 0x00 0x00 0x0F 0x00F0 0x003 0x0000000C 0xF1090798
0x00000800

// dbc: init 1
0x29 0x01 0x00 0x0F 0x00F0 0x00D 0x0000000C 0xF109089C
0x00000000 0x000003CB 0x000001C0 0x000003CB 0x000001C0 0x0000003F
0x00000002 0x00000FFF 0x00000000 0x00000000 0x40850423

// dbc: COREX0K0
0x29 0x01 0x00 0x0F 0x00FE 0x002 0x0000000C 0xF109079C


// dbc: off
0x29 0x01 0x00 0x0F 0x0000 0x003 0x0000000C 0xF10908C4
0x40850423

// dbc: on
0x29 0x01 0x00 0x0F 0x0001 0x003 0x0000000C 0xF10908C4
0x40840423

// dbc: level 0
0x29 0x01 0x00 0x0F 0x0010 0x004 0x0000000C 0xF10908B0
0x00000000 0x00000000

// dbc: level 1
0x29 0x01 0x00 0x0F 0x0011 0x004 0x0000000C 0xF10908B0
0x00000027 0x00000002

// dbc: level 2
0x29 0x01 0x00 0x0F 0x0012 0x004 0x0000000C 0xF10908B0
0x00000022 0x00000002

// dbc: level 3
0x29 0x01 0x00 0x0F 0x0013 0x004 0x0000000C 0xF10908B0
0x0000001B 0x00000002

// dbc: compenk table 0
0x29 0x01 0x00 0x0F 0x0020 0x003 0x0000000C 0xF10908BC
0x00000000

// dbc: compenk table 1
0x29 0x01 0x00 0x0F 0x0021 0x003 0x0000000C 0xF10908BC
0x00000001

// dbc: income table 0
0x29 0x01 0x00 0x0F 0x0030 0x003 0x0000000C 0xF10908C0
0x00000000

// dbc: income table 1
0x29 0x01 0x00 0x0F 0x0031 0x003 0x0000000C 0xF10908C0
0x00000001

// dbc: bitmask: bl_user
0x29 0x01 0x00 0x0F 0x00FD 0x003 0x0000000C 0xF10908B8
0x00000FFF

// dbc: bitmask: led0d_gain
0x29 0x01 0x00 0x0F 0x00FC 0x003 0x0000000C 0xF10908B0
0x00000000

// blc_pwm: init
0x29 0x01 0x00 0x06 0x00F0 0x003 0xFFFFFFF4
0xF1040014 0x0001100A

// blc_pwm: disable
0x29 0x01 0x00 0x06 0x0000 0x003 0xFFFFFFF4
0xF1040000 0x00000481

// blc_pwm: enable
0x29 0x01 0x00 0x06 0x0001 0x003 0xFFFFFFF4
0xF1040000 0x00000484

// blc_pwm: bitmask: PWM_GEN_FREQ_SET
0x29 0x01 0x00 0x06 0x00FD 0x003 0xFFFFFFF4
0xF1040010 0x00000001

// dsc_dec: sw_rst_en
0x29 0x01 0x00 0x07 0x00D0 0x004 0x0000000C 0xF1091C9C
0x00490358 0x00480358

// dsc_dec: init
0x29 0x01 0x00 0x07 0x00F0 0x01C 0x0000000C 0xF10906A4
0x00480358 0x01E001E0 0x00000800 0x89000011 0x24098030 0x48003804
0x1C021C02 0x2A040002 0xFD062000 0x0C000700 0x6A015B01 0xF0100018
0x00200C03 0x330B0B06 0x382A1C0E 0x69625446 0x7B797770 0x02017E7D
0x40090001 0xFC19BE09 0xF819FA19 0x781A381A 0xF62AB61A 0x742B342B
0xF463743B 0x00000001

// dsc_enc: init
0x29 0x01 0x00 0x08 0x00F0 0x024 0x0000000C 0xF109070C
0x00000003 0x00000002 0x00B40168 0x0002021C 0x00B4010E 0x000097E0
0x00009900 0x00004BF0 0xC0122010 0x00B4021C 0x00000000 0x89000011
0x24098030 0x48003804 0x1C021C02 0x0E020002 0xFD062000 0x0C000700
0x6A015B01 0xF0100018 0x00200C03 0x330B0B06 0x382A1C0E 0x69625446
0x7B797770 0x02017E7D 0x40090001 0xFC19BE09 0xF819FA19 0x781A381A
0xF62AB61A 0x742B342B 0xF463743B 0x00000004

// scaler_pp: init
0x29 0x01 0x00 0x0B 0x00F0 0x014 0x0000000C 0xF1090928
0x00026620 0x00000441 0x00080000 0x00080000 0x00006410 0x09240924
0x00020003 0x00020003 0x00000000 0x0000001E 0x04380438 0x00080000
0x00080000 0x00020003 0x00020003 0x00006410 0x00000000 0x00000800

// dma: init
0x29 0x01 0x00 0x11 0x00F0 0x09A 0x0000000C 0xF1090000
0x10010600 0xF1100050 0x801B0604 0xF1140000 0x80030670 0xF1140108
0x8002067C 0xF1141004 0x80010684 0xF1150000 0x80060688 0xF1380000
0x800106A0 0xF1390000 0x001906A4 0xF1180000 0x00010708 0xF119FF00
0x000A070C 0xF13C0000 0x00010734 0xF13C0054 0x00160738 0xF13C0064
0x00010790 0xF13C0114 0x00010794 0xF1100050 0x84010798 0xF1300000
0x8440079C 0xF1300088 0x840B089C 0xF13001E4 0xC41808C8 0xF1318000
0x04120928 0xF1240000 0xC5620970 0xF11D1104 0x856D0EF8 0xF11C0000
0x840214AC 0xF11D1000 0x840114B4 0xF11C0348 0x840214B8 0xF11D10FC
0x040114C0 0xF1140008 0x800114C4 0xF1140044 0x884014C8 0xF1480000
0x888D15C8 0xF1480200 0x880117FC 0xF1480434 0x88011800 0xF1100808
0x88011804 0xF1100818 0x88011808 0xF1100A00 0x8801180C 0xF1100010
0x88011810 0xF110001C 0x88011814 0xF1100080 0x88011818 0xF1100104
0x8802181C 0xF1100144 0x88011824 0xF1100238 0x88021828 0xF1100300
0x88011830 0xF1101804 0x88011834 0xF1440200 0x88011838 0xF1440004
0x8801183C 0xF1440210 0x88081840 0xF1400000 0x88041860 0xF1400040
0x8C011870 0xF10914B4 0x08011874 0xF000005C 0x88011878 0xF0000038
0x8900187C 0xF1607C00 0x88011C7C 0xF1100A08 0x88011C80 0xF1100A14
0x88011C84 0xF1100A1C 0x88011C88 0xF1100A24 0x88011C8C 0xF1100A2C
0x88011C90 0xF1100800 0x90011C94 0xF1140000 0x90011C98 0xF1140000
0x10011C9C 0xF1180000 0x10011CA0 0xF1180000 0xAC1B0604 0xF1140000
0xAC030670 0xF1140108 0xAC02067C 0xF1141004 0xAC010684 0xF1150000
0xA04014C8 0xF1480000 0xA08D15C8 0xF1480200 0xA00117FC 0xF1480434
0xA56D0EF8 0xF11C0000 0xA40214AC 0xF11D1000 0xA40114B4 0xF11C0348
0xA40214B8 0xF11D10FC 0xA8010798 0xF1300000 0xA840079C 0xF1300088
0xA80B089C 0xF13001E4 0xB0060688 0xF1380000 0xB00106A0 0xF1390000
0xAC0114C4 0xF1140044

// dma: init ctrl
0x29 0x01 0x00 0x11 0x00E1 0x013 0xFFFFFFF4
0xF1080000 0x0000000D 0xF1080004 0x00000000 0xF1080008 0x004C0000
0xF1080014 0xFFFFFFFF 0xF1080104 0x00000004 0xF1080108 0x00000002
0xF108010C 0x00000002 0xF1080110 0x00000001 0xF1080114 0x00000001

// dma: trigger HDR
0x29 0x01 0x00 0x11 0x00E2 0x005 0xFFFFFFF4
0xF1080004 0x00000000 0xF1080004 0x00000A00

// dma: trigger DPP
0x29 0x01 0x00 0x11 0x00E3 0x005 0xFFFFFFF4
0xF1080004 0x00000000 0xF1080004 0x00000100

// dma: trigger PQ
0x29 0x01 0x00 0x11 0x00E4 0x005 0xFFFFFFF4
0xF1080004 0x00000000 0xF1080004 0x00000800

// dma: trigger DBC
0x29 0x01 0x00 0x11 0x00E5 0x005 0xFFFFFFF4
0xF1080004 0x00000000 0xF1080004 0x00000C00

// dma: PD08 power protection
0x29 0x01 0x00 0x11 0x00E6 0x003 0xFFFFFFF4
0xF1080104 0x00000004

// dma: trigger DPORT
0x29 0x01 0x00 0x11 0x00E7 0x005 0xFFFFFFF4
0xF1080004 0x00000000 0xF1080004 0x00001000

// dma: PD11 power protection
0x29 0x01 0x00 0x11 0x00E8 0x003 0xFFFFFFF4
0xF1080110 0x00000001

// hdr: top_ctrl
0x29 0x01 0x00 0x09 0x0000 0x00E 0x0000000C 0xF1090EF8
0x00107AB5 0x00065905 0x00000D3F 0x09240438 0x00000800 0x00000000
0x00000000 0x00000020 0x00200020 0x00000020 0x00000020 0x00000020

// hdr: lce_ctrl
0x29 0x01 0x00 0x09 0x0010 0x038 0x0000000C 0xF1090F28
0x00003001 0x04370000 0x09230000 0x001D40D8 0x00000100 0x001B00D8
0x00360288 0x003A81D4 0x0075057C 0x0287D1F4 0x0467D17C 0x0197D12C
0x00960000 0x0C800961 0x000013CA 0x00020014 0x000003FF 0x000003FF
0x02320F7D 0x023C0000 0x00FFF000 0x00002002 0x0000040C 0x0200007F
0x00040810 0x00FDF309 0x0000009E 0x00033D91 0x0000A8B0 0x00100000
0x1D87B200 0x1986B9C3 0x1555B182 0x1134A53F 0x0D33A0FD 0x0982ACBE
0x0641D086 0x03A11C55 0x01A08C2E 0x00703012 0x00000403 0x000012F6
0x000008C0 0x1D87B200 0x1986B9C3 0x1555B182 0x1134A53F 0x0D33A0FD
0x0982ACBE 0x0641D086 0x03A11C55 0x01A08C2E 0x00703012 0x00000403

// hdr: gra_ctrl
0x29 0x01 0x00 0x09 0x0020 0x007 0x0000000C 0xF1091000
0x05001FFF 0x1F100700 0x00080001 0x00011133 0x07AA0800

// hdr: tl_ctrl
0x29 0x01 0x00 0x09 0x0030 0x04A 0x0000000C 0xF1091014
0x1E77C1FA 0x1CC755DE 0x1B06E9C3 0x195679A7 0x17B60D8C 0x1605A572
0x14653D57 0x12D4D53E 0x11447124 0x0FC4110C 0x0E43B0F4 0x0CE354DD
0x0B82FCC6 0x0A32A8B1 0x0902589D 0x07D20C89 0x06C1C477 0x05B18066
0x04C14456 0x03E10C47 0x0320D83A 0x0260A82E 0x01D08023 0x01405C1A
0x00D03C12 0x0070240B 0x00301406 0x00100402 0x00000000 0x00000000
0x1C3755E7 0x18C679B0 0x1575A57B 0x1244D546 0x0F441114 0x0C6354E4
0x09D2A8B8 0x07720C90 0x0561806C 0x03A10C4C 0x0230A832 0x01205C1D
0x0060240D 0x00000403 0x00000000 0x00000000 0x00000000 0x00000000
0x00000000 0x00000000 0x00000000 0x00000000 0x00000000 0x00000000
0x00000000 0x00000000 0x00000000 0x00000000 0x00000000 0x00000400
0x00000400 0x0003EFBF 0x0003EFBE 0x0003DF7D 0x0000003C 0x00038EFF
0x00028BF2 0x0001E926 0x00000017 0x00000000 0x00000000 0x5A2DB058

// hdr: tm_ctrl
0x29 0x01 0x00 0x09 0x0040 0x035 0x0000000C 0xF1091134
0x01290000 0x040D0309 0x06670568 0x07EC07EC 0x07EC07EC 0x07EC07EC
0x07EC07EC 0x000007EC 0x01290000 0x040D0309 0x06670568 0x07EC07EC
0x07EC07EC 0x07EC07EC 0x07EC07EC 0x000007EC 0x012C03E8 0x00640064
0x00280032 0x00280028 0x00280028 0x00280028 0x00280028 0x0A0A0A02
0x10100002 0x10101010 0x00001010 0x0FFF0FFF 0x005F0005 0x07EC1A02
0x00000000 0x000001A8 0x00001001 0x00000000 0x00000000 0x00000000
0x00000000 0x00000000 0x00000000 0x00000000 0x00000000 0x00000000
0x00000000 0x00000000 0x00000000 0x04000100 0x00000202 0x00000883
0x00000080 0x0000021C 0x0100021C

// hdr: tm_sw_cfg
0x29 0x01 0x00 0x09 0x0050 0x013 0x0000000C 0xF1091200
0x01290000 0x040D0309 0x06670568 0x07EC07EC 0x07EC07EC 0x07EC07EC
0x07EC07EC 0x000007EC 0x01290000 0x040D0309 0x06670568 0x07EC07EC
0x07EC07EC 0x07EC07EC 0x07EC07EC 0x000007EC 0x00000000

// hdr: ratio_ctrl
0x29 0x01 0x00 0x09 0x0060 0x005 0x0000000C 0xF1091244
0x00001000 0x00001000 0x00000100

// hdr: col_ctrl
0x29 0x01 0x00 0x09 0x0070 0x00A 0x0000000C 0xF1091250
0x0000194D 0x00140678 0x00140763 0x00000CCC 0x00000CCC 0x00808080
0x00080000 0x00080000

// hdr: csc_ctrl
0x29 0x01 0x00 0x09 0x0090 0x04D 0x0000000C 0xF1091270
0x00000E38 0x00001278 0x00000C18 0x00001058 0x00000E38 0x00000E3C
0x00000D9B 0x00002DC6 0x0000049F 0x0000F8AB 0x0000E755 0x00002000
0x00002000 0x0000E2EF 0x0000FD11 0x00000000 0x00000000 0x00000000
0x0001A649 0x00016E2A 0x0000B8CF 0x0000D9BE 0x0002DC55 0x000049EC
0x000013CB 0x00007A0E 0x0003CD58 0x00000000 0x00000000 0x00000000
0x00000D9B 0x00002DC6 0x0000049F 0x000FF8AB 0x000FE755 0x00002000
0x00002000 0x000FE2EF 0x000FFD11 0x00000000 0x00002000 0x00002000
0x0000A09F 0x0000544C 0x00000B14 0x000011B0 0x0000EB68 0x000002E5
0x00000433 0x0000168A 0x0000E543 0x00000000 0x00000000 0x00000000
0x00004000 0x00000000 0x00000000 0x00000000 0x00004000 0x00000000
0x00000000 0x00000000 0x00004000 0x00004000 0x00000000 0x000064C9
0x00004000 0x0000F403 0x0000E20A 0x00004000 0x000076C2 0x00000000
0x00000000 0x00000000 0x00000000

// hdr: lut_ctrl
0x29 0x01 0x00 0x09 0x00A0 0x008 0x0000000C 0xF109139C
0x000000A8 0x000000A8 0x00000090 0x00000090 0x000000A8 0x00000090

// hdr: scurve_ctrl
0x29 0x01 0x00 0x09 0x00B0 0x00B 0x0000000C 0xF10913B4
0x00000000 0x00000000 0x00000400 0x00140118 0x00000190 0x00200080
0x0000012C 0x00008000 0x000003E8

// hdr: de_ctrl
0x29 0x01 0x00 0x09 0x00C0 0x020 0x0000000C 0xF10913D8
0x000C0000 0x00645040 0x00008080 0x0000012A 0x0000018D 0x00000309
0x00000667 0x000007EC 0x00204080 0x00000010 0x0000001A 0x00000062
0x0000012A 0x0000018D 0x00000246 0x00050118 0x00801201 0x01690C0C
0x001021C0 0x00000000 0x0FFF2800 0x00004002 0x0AF40FFF 0x1079512A
0x1003E81E 0x08012C50 0x01A80100 0x00080200 0x0066640A 0x0033320A

// hdr: ai_ctrl
0x29 0x01 0x00 0x0A 0x0000 0x016 0x0000000C 0xF1091450
0x001C4002 0x0000000F 0x00011000 0x0005007D 0x04040404 0x00040404
0x000115B8 0x000115C8 0x000115D8 0x000115E8 0x000115F8 0x000115F8
0x000115F8 0x00000380 0x00040040 0x00000100 0x000003FF 0x00000000
0x00000000 0x88000007

// hdr: demo_ctrl
0x29 0x01 0x00 0x09 0x00D0 0x005 0x0000000C 0xF10914A0
0x00000000 0x00000000 0x00000000

// hdr: ai_ctrl 2
0x29 0x01 0x00 0x0A 0x0010 0x004 0x0000000C 0xF10914AC
0x0000007D 0x000000FA

// hdr: update
0x29 0x01 0x00 0x09 0x0080 0x004 0x0000000C 0xF10914B8
0x00000000 0x00000004

// hdr: tm_trig
0x29 0x01 0x00 0x09 0x00FB 0x003 0x0000000C 0xF10914B4
0x00000000

// hdr: ctrl
0x29 0x01 0x00 0x09 0x00FD 0x003 0x0000000C 0xF1090F00
0x00000D3F

// hdr: path_ctrl
0x29 0x01 0x00 0x09 0x00FC 0x003 0x0000000C 0xF1090EFC
0x00065905

// hdr: top_ctrl l2
0x29 0x01 0x00 0x09 0x0002 0x00E 0x0000000C 0xF1090EF8
0x0010B00B 0x00021358 0x000014F0 0x09240438 0x00000800 0x00000000
0x00000000 0x00000020 0x00200020 0x00000020 0x00000020 0x00000020

// hdr: lce_ctrl l2
0x29 0x01 0x00 0x09 0x0012 0x038 0x0000000C 0xF1090F28
0x00003001 0x04370000 0x09230000 0x001D40D8 0x00000100 0x001B00D8
0x00360288 0x003A81D4 0x0075057C 0x0287D1F4 0x0467D17C 0x0197D12C
0x00960000 0x0C8008C9 0x00000BD7 0x00020014 0x00000002 0x000003FF
0x02640AD2 0x020A0000 0x00AF4000 0x00002EBE 0x0000040C 0x000A0057
0x0005E293 0x00AEC4CB 0x0000006B 0x0004C8F8 0x00006AD2 0x00400000
0x1D87B200 0x1986B9C3 0x1555B182 0x1134A53F 0x0D33A0FD 0x0982ACBE
0x0641D086 0x03A11C55 0x01A08C2E 0x00703012 0x00000403 0x000012F6
0x000008C0 0x1D87B200 0x1986B9C3 0x1555B182 0x1134A53F 0x0D33A0FD
0x0982ACBE 0x0641D086 0x03A11C55 0x01A08C2E 0x00703012 0x00000403

// hdr: gra_ctrl l2
0x29 0x01 0x00 0x09 0x0022 0x007 0x0000000C 0xF1091000
0x05014FFF 0x28140802 0x00080190 0x00042233 0x07AA0FA0

// hdr: tl_ctrl l2
0x29 0x01 0x00 0x09 0x0032 0x04A 0x0000000C 0xF1091014
0x1C3755E7 0x18C679B0 0x1575A57B 0x1244D546 0x0F441114 0x0C6354E4
0x09D2A8B8 0x07720C90 0x0561806C 0x03A10C4C 0x0230A832 0x01205C1D
0x0060240D 0x00000403 0x00000000 0x00000000 0x00000000 0x00000000
0x00000000 0x00000000 0x00000000 0x00000000 0x00000000 0x00000000
0x00000000 0x00000000 0x00000000 0x00000000 0x00000000 0x00000000
0x18C6C1D5 0x12451969 0x0C639104 0x077240AA 0x03A13060 0x0120742A
0x00000C09 0x00000800 0x00000000 0x00000000 0x00000000 0x00000000
0x00000000 0x00000000 0x00000000 0x00000000 0x00000000 0x00000000
0x00000000 0x00000000 0x00000000 0x00000000 0x00000000 0x00000000
0x00000000 0x00000000 0x00000000 0x00000000 0x00000000 0x00000400
0x00000400 0x0003EFBF 0x0003EFBE 0x0003DF7D 0x0000003C 0x00038EFF
0x00028BF2 0x0001E926 0x00000017 0x00000000 0x00000000 0x2E175A2D

// hdr: tm_ctrl l2
0x29 0x01 0x00 0x09 0x0042 0x035 0x0000000C 0xF1091134
0x07F50000 0x09A30916 0x0A7009F2 0x0B230AD2 0x0BBE0B67 0x0C7B0C06
0x0D660CF3 0x00000FFF 0x05720000 0x06990638 0x072506CF 0x07A00768
0x080A07CE 0x088B083B 0x092C08DD 0x00000AF4 0x0014000A 0x00C80032
0x03E800C8 0x02580320 0x00C800C8 0x00140064 0x00140014 0x02010101
0x06040303 0x02020202 0x00000202 0x0AF40FFF 0x00FA0001 0x08201A03
0x00000000 0x000001A8 0x00001001 0x00000000 0x00000000 0x00000000
0x00000000 0x00000000 0x00000000 0x00000000 0x00000000 0x00000000
0x00000000 0x00000000 0x00000000 0x001400AF 0x00000004 0x00000D66
0x00000080 0x00002710 0x00AF021C

// hdr: ratio_ctrl l2
0x29 0x01 0x00 0x09 0x0062 0x005 0x0000000C 0xF1091244
0x00001000 0x000035FC 0x00001285

// hdr: col_ctrl l2
0x29 0x01 0x00 0x09 0x0072 0x00A 0x0000000C 0xF1091250
0x0000197D 0x0014060F 0x001406EF 0x00000CCC 0x00000CCC 0x00808080
0x00080000 0x00080000

// hdr: csc_ctrl l2
0x29 0x01 0x00 0x09 0x0092 0x04D 0x0000000C 0xF1091270
0x00000E38 0x00001278 0x00000C18 0x00001058 0x00000E38 0x00000E38
0x00004000 0x00000000 0x00000000 0x00000000 0x00004000 0x00000000
0x00000000 0x00000000 0x00004000 0x00000000 0x00000000 0x00000000
0x00028C3E 0x00009416 0x0000ACEF 0x00010D01 0x0002B645 0x00003CB9
0x00000000 0x00001CBF 0x00043E72 0x00000000 0x00000000 0x00000000
0x00000D9B 0x00002DC6 0x0000049F 0x000FF8AB 0x000FE755 0x00002000
0x00002000 0x000FE2EF 0x000FFD11 0x00000000 0x00002000 0x00002000
0x0000A09F 0x0000544C 0x00000B14 0x000011B0 0x0000EB68 0x000002E5
0x00000433 0x0000168A 0x0000E543 0x00000000 0x00000000 0x00000000
0x00004000 0x00000000 0x00000000 0x00000000 0x00004000 0x00000000
0x00000000 0x00000000 0x00004000 0x00004000 0x0000008D 0x0000071B
0x00004000 0x0000FF73 0x0000F8E5 0x00004000 0x000023D7 0x0000EB7B
0x00000000 0x00000000 0x00000000

// hdr: lut_ctrl l2
0x29 0x01 0x00 0x09 0x00A2 0x008 0x0000000C 0xF109139C
0x000000A8 0x000000A8 0x00000090 0x00000090 0x000000A8 0x00000090

// hdr: scurve_ctrl l2
0x29 0x01 0x00 0x09 0x00B2 0x00B 0x0000000C 0xF10913B4
0x00000000 0x00000000 0x00000040 0x00100100 0x00000190 0x00200080
0x0000012C 0x00008000 0x000003E8

// hdr: de_ctrl l2
0x29 0x01 0x00 0x09 0x00C2 0x020 0x0000000C 0xF10913D8
0x00040000 0x00645040 0x00008080 0x00000266 0x00000303 0x000004CB
0x00000752 0x00000821 0x00408080 0x00000020 0x0000002F 0x000000DB
0x00000266 0x00000303 0x000003F7 0x00050168 0x00801201 0x016B0C0C
0x001021C0 0x000000FF 0x0AF42800 0x00004002 0x0AF40AF4 0x10D3C266
0x1003E81E 0x08012C50 0x01A80100 0x00080200 0x0066640A 0x0033320A

// hdr: tm_sw_cfg l2
0x29 0x01 0x00 0x09 0x0052 0x013 0x0000000C 0xF1091200
0x07F50000 0x09A30916 0x0A7009F2 0x0B230AD2 0x0BBE0B67 0x0C7B0C06
0x0D660CF3 0x00000FFF 0x05720000 0x06990638 0x072506CF 0x07A00768
0x080A07CE 0x088B083B 0x092C08DD 0x00000AF4 0x00000000

// hdr: top_ctrl l3
0x29 0x01 0x00 0x09 0x0003 0x00E 0x0000000C 0xF1090EF8
0x0010B00B 0x00021350 0x000014F0 0x09240438 0x00000800 0x00000000
0x00000000 0x00000020 0x00200020 0x00000020 0x00000020 0x00000020

// hdr: lce_ctrl l3
0x29 0x01 0x00 0x09 0x0013 0x038 0x0000000C 0xF1090F28
0x00003001 0x04370000 0x09230000 0x001D40D8 0x00000100 0x001B00D8
0x00360288 0x003A81D4 0x0075057C 0x0287D1F4 0x0467D17C 0x0197D12C
0x00960000 0x0C8008C9 0x00000BD7 0x00020014 0x00000002 0x000003FF
0x02640AD2 0x020A0000 0x00AF4000 0x00002EBE 0x0000040C 0x000A0057
0x0005E293 0x00AEC4CB 0x0000006B 0x0004C8F8 0x00006AD2 0x00400000
0x1D87B200 0x1986B9C3 0x1555B182 0x1134A53F 0x0D33A0FD 0x0982ACBE
0x0641D086 0x03A11C55 0x01A08C2E 0x00703012 0x00000403 0x000012F6
0x000008C0 0x1D87B200 0x1986B9C3 0x1555B182 0x1134A53F 0x0D33A0FD
0x0982ACBE 0x0641D086 0x03A11C55 0x01A08C2E 0x00703012 0x00000403

// hdr: gra_ctrl l3
0x29 0x01 0x00 0x09 0x0023 0x007 0x0000000C 0xF1091000
0x05014FFF 0x28140802 0x00080190 0x00042233 0x07AA0FA0

// hdr: tl_ctrl l3
0x29 0x01 0x00 0x09 0x0033 0x04A 0x0000000C 0xF1091014
0x1C3755E7 0x18C679B0 0x1575A57B 0x1244D546 0x0F441114 0x0C6354E4
0x09D2A8B8 0x07720C90 0x0561806C 0x03A10C4C 0x0230A832 0x01205C1D
0x0060240D 0x00000403 0x00000000 0x00000000 0x00000000 0x00000000
0x00000000 0x00000000 0x00000000 0x00000000 0x00000000 0x00000000
0x00000000 0x00000000 0x00000000 0x00000000 0x00000000 0x00000000
0x18C6C1D5 0x12451969 0x0C639104 0x077240AA 0x03A13060 0x0120742A
0x00000C09 0x00000800 0x00000000 0x00000000 0x00000000 0x00000000
0x00000000 0x00000000 0x00000000 0x00000000 0x00000000 0x00000000
0x00000000 0x00000000 0x00000000 0x00000000 0x00000000 0x00000000
0x00000000 0x00000000 0x00000000 0x00000000 0x00000000 0x00000400
0x00000400 0x0003EFBF 0x0003EFBE 0x0003DF7D 0x0000003C 0x00038EFF
0x00028BF2 0x0001E926 0x00000017 0x00000000 0x00000000 0x2E175A2D

// hdr: tm_ctrl l3
0x29 0x01 0x00 0x09 0x0043 0x035 0x0000000C 0xF1091134
0x02660000 0x06B404CB 0x0820078F 0x09F20943 0x0B670AD2 0x0FFF0C06
0x0FFF0FFF 0x00000FFF 0x01A40000 0x04970348 0x0590052C 0x06CF0657
0x07CE0768 0x0AF4083B 0x0AF40AF4 0x00000AF4 0x0014000A 0x00C80032
0x03E800C8 0x02580320 0x00C800C8 0x00140064 0x00140014 0x02010101
0x06040303 0x02020202 0x00000202 0x0AF40FFF 0x00FA0001 0x08201A03
0x00000000 0x000001A8 0x00001001 0x00000000 0x00000000 0x00000000
0x00000000 0x00000000 0x00000000 0x00000000 0x00000000 0x00000000
0x00000000 0x00000000 0x00000000 0x001400AF 0x00000006 0x00000D66
0x00000080 0x00002710 0x00AF021C

// hdr: ratio_ctrl l3
0x29 0x01 0x00 0x09 0x0063 0x005 0x0000000C 0xF1091244
0x00001000 0x000035FC 0x00001285

// hdr: col_ctrl l3
0x29 0x01 0x00 0x09 0x0073 0x00A 0x0000000C 0xF1091250
0x0000197D 0x0014060F 0x001406EF 0x00000CCC 0x00000CCC 0x00808080
0x00080000 0x00080000

// hdr: csc_ctrl l3
0x29 0x01 0x00 0x09 0x0093 0x04D 0x0000000C 0xF1091270
0x00000E38 0x00001278 0x00000C18 0x00001058 0x00000E38 0x00000E38
0x00004000 0x00000000 0x00000000 0x00000000 0x00004000 0x00000000
0x00000000 0x00000000 0x00004000 0x00000000 0x00000000 0x00000000
0x00028C3E 0x00009416 0x0000ACEF 0x00010D01 0x0002B645 0x00003CB9
0x00000000 0x00001CBF 0x00043E72 0x00000000 0x00000000 0x00000000
0x00000D9B 0x00002DC6 0x0000049F 0x000FF8AB 0x000FE755 0x00002000
0x00002000 0x000FE2EF 0x000FFD11 0x00000000 0x00002000 0x00002000
0x0000A09F 0x0000544C 0x00000B14 0x000011B0 0x0000EB68 0x000002E5
0x00000433 0x0000168A 0x0000E543 0x00000000 0x00000000 0x00000000
0x00004000 0x00000000 0x00000000 0x00000000 0x00004000 0x00000000
0x00000000 0x00000000 0x00004000 0x00004000 0x0000008D 0x0000071B
0x00004000 0x0000FF73 0x0000F8E5 0x00004000 0x000023D7 0x0000EB7B
0x00000000 0x00000000 0x00000000

// hdr: lut_ctrl l3
0x29 0x01 0x00 0x09 0x00A3 0x008 0x0000000C 0xF109139C
0x000000A8 0x000000A8 0x00000090 0x00000090 0x000000A8 0x00000090

// hdr: scurve_ctrl l3
0x29 0x01 0x00 0x09 0x00B3 0x00B 0x0000000C 0xF10913B4
0x00000000 0x00000000 0x00000040 0x00100100 0x00000190 0x00200080
0x0000012C 0x00008000 0x000003E8

// hdr: de_ctrl l3
0x29 0x01 0x00 0x09 0x00C3 0x020 0x0000000C 0xF10913D8
0x00040000 0x00645040 0x00008080 0x00000266 0x00000303 0x000004CB
0x00000752 0x00000821 0x00408080 0x00000020 0x0000002F 0x000000DB
0x00000266 0x00000303 0x000003F7 0x00050168 0x00801201 0x016B0C0C
0x001021C0 0x000000FF 0x0AF42800 0x00004002 0x0AF40AF4 0x11B9A12A
0x100D3065 0x08012C50 0x01A80100 0x00080200 0x0066640A 0x0033320A

// hdr: top_ctrl l5
0x29 0x01 0x00 0x09 0x0005 0x00E 0x0000000C 0xF1090EF8
0x00107AB5 0x00064194 0x00000D7F 0x09240438 0x00000800 0x00000000
0x00000000 0x00000020 0x00200020 0x00000020 0x00000020 0x00000020

// hdr: lce_ctrl l5
0x29 0x01 0x00 0x09 0x0015 0x038 0x0000000C 0xF1090F28
0x00003011 0x04370000 0x09230000 0x001D40D8 0x00000100 0x001B00D8
0x00360288 0x003A81D4 0x0075057C 0x0287D1F4 0x0647D17C 0x0407D12C
0x0096000A 0x032007EC 0x00000F7D 0x00020032 0x00000002 0x000001F4
0x025A07EC 0x02140ED3 0x00FFF000 0x00002002 0x0000040C 0x000A007F
0x00040810 0x00FBF40D 0x0000009E 0x00033D91 0x00007E65 0x00080000
0x1D87B200 0x1986B9C3 0x1555B182 0x1134A53F 0x0D33A0FD 0x0982ACBE
0x0641D086 0x03A11C55 0x01A08C2E 0x00703012 0x00000403 0x000012F6
0x000008C0 0x1D87B200 0x1986B9C3 0x1555B182 0x1134A53F 0x0D33A0FD
0x0982ACBE 0x0641D086 0x03A11C55 0x01A08C2E 0x00703012 0x00000403

// hdr: gra_ctrl l5
0x29 0x01 0x00 0x09 0x0025 0x007 0x0000000C 0xF1091000
0x050140C8 0x28140802 0x00080190 0x00042233 0x07AA0FA0

// hdr: tl_ctrl l5
0x29 0x01 0x00 0x09 0x0035 0x04A 0x0000000C 0xF1091014
0x1E77C1FA 0x1CC755DE 0x1B06E9C3 0x195679A7 0x17B60D8C 0x1605A572
0x14653D57 0x12D4D53E 0x11447124 0x0FC4110C 0x0E43B0F4 0x0CE354DD
0x0B82FCC6 0x0A32A8B1 0x0902589D 0x07D20C89 0x06C1C477 0x05B18066
0x04C14456 0x03E10C47 0x0320D83A 0x0260A82E 0x01D08023 0x01405C1A
0x00D03C12 0x0070240B 0x00301406 0x00100402 0x00000000 0x00000000
0x1C3755E7 0x18C679B0 0x1575A57B 0x1244D546 0x0F441114 0x0C6354E4
0x09D2A8B8 0x07720C90 0x0561806C 0x03A10C4C 0x0230A832 0x01205C1D
0x0060240D 0x00000403 0x00000000 0x00000000 0x00000000 0x00000000
0x00000000 0x00000000 0x00000000 0x00000000 0x00000000 0x00000000
0x00000000 0x00000000 0x00000000 0x00000000 0x00000000 0x00000400
0x00000400 0x0003EFBF 0x0003EFBE 0x0003DF7D 0x0000003C 0x00038EFF
0x00028BF2 0x0001E926 0x00000017 0x00000000 0x00000000 0x5A2DB058

// hdr: tm_ctrl l5
0x29 0x01 0x00 0x09 0x0045 0x035 0x0000000C 0xF1091134
0x01290000 0x0246018D 0x03980309 0x04CC040D 0x06670568 0x07EC0738
0x07EC07EC 0x000007EC 0x01290000 0x0246018D 0x03980309 0x04CC040D
0x06670568 0x07EC0738 0x07EC07EC 0x000007EC 0x032003E8 0x0032012C
0x00280028 0x00280028 0x00280028 0x00280028 0x00280028 0x040A0A02
0x10101000 0x10101010 0x00001010 0x0FFF0FFF 0x0080000C 0x07EC1A02
0x00000000 0x000001A8 0x00001001 0x00000000 0x00000000 0x00000000
0x00000000 0x00000000 0x00000000 0x00000000 0x00000000 0x00000000
0x00000000 0x00000000 0x00000000 0x00140100 0x00000002 0x00000883
0x00000080 0x0000021C 0x0100021C

// hdr: ratio_ctrl l5
0x29 0x01 0x00 0x09 0x0065 0x005 0x0000000C 0xF1091244
0x00001000 0x00001000 0x00000100

// hdr: col_ctrl l5
0x29 0x01 0x00 0x09 0x0075 0x00A 0x0000000C 0xF1091250
0x0000194D 0x00140678 0x00140763 0x00000CCC 0x00000CCC 0x00808080
0x00080000 0x00080000

// hdr: csc_ctrl l5
0x29 0x01 0x00 0x09 0x0095 0x04D 0x0000000C 0xF1091270
0x00000E38 0x00001278 0x00000C18 0x00001058 0x00000E38 0x00000E3C
0x00000D9B 0x00002DC6 0x0000049F 0x0000F8AB 0x0000E755 0x00002000
0x00002000 0x0000E2EF 0x0000FD11 0x00000000 0x00000000 0x00000000
0x0001A649 0x00016E2A 0x0000B8CF 0x0000D9BE 0x0002DC55 0x000049EC
0x000013CB 0x00007A0E 0x0003CD58 0x00000000 0x00000000 0x00000000
0x00000D9B 0x00002DC6 0x0000049F 0x000FF8AB 0x000FE755 0x00002000
0x00002000 0x000FE2EF 0x000FFD11 0x00000000 0x00002000 0x00002000
0x0000A09F 0x0000544C 0x00000B14 0x000011B0 0x0000EB68 0x000002E5
0x00000433 0x0000168A 0x0000E543 0x00000000 0x00000000 0x00000000
0x00004000 0x00000000 0x00000000 0x00000000 0x00004000 0x00000000
0x00000000 0x00000000 0x00004000 0x00004000 0x00000000 0x000064C9
0x00004000 0x0000F403 0x0000E20A 0x00004000 0x000076C2 0x00000000
0x00000000 0x00000000 0x00000000

// hdr: lut_ctrl l5
0x29 0x01 0x00 0x09 0x00A5 0x008 0x0000000C 0xF109139C
0x000000A8 0x000000A8 0x00000090 0x00000090 0x000000A8 0x00000090

// hdr: scurve_ctrl l5
0x29 0x01 0x00 0x09 0x00B5 0x00B 0x0000000C 0xF10913B4
0x00000000 0x00000000 0x00000040 0x0012C10E 0x000003E8 0x00200080
0x0000012C 0x00008000 0x00000000

// hdr: de_ctrl l5
0x29 0x01 0x00 0x09 0x00C5 0x020 0x0000000C 0xF10913D8
0x00040000 0x00805040 0x00008080 0x0000012A 0x000001D6 0x00000309
0x000007EC 0x00000FFF 0x00204080 0x00000010 0x00000062 0x000000DF
0x0000012A 0x0000018D 0x00000246 0x00064168 0x00801201 0x02E70C0C
0x001021C0 0x000000FF 0x0FFF4000 0x00004002 0x0FFF0FFF 0x20F7E12A
0x100FFC1E 0x08011850 0x01A80100 0x00080200 0x0066640A 0x0033320A

// hdr: top_ctrl l6
0x29 0x01 0x00 0x09 0x0006 0x00E 0x0000000C 0xF1090EF8
0x00107AB5 0x00064194 0x00000D7F 0x09240438 0x00000800 0x00000000
0x00000000 0x00000020 0x00200020 0x00000020 0x00000020 0x00000020

// hdr: lce_ctrl l6
0x29 0x01 0x00 0x09 0x0016 0x038 0x0000000C 0xF1090F28
0x00003011 0x04370000 0x09230000 0x001D40D8 0x00000100 0x001B00D8
0x00360288 0x003A81D4 0x0075057C 0x0287D1F4 0x0647D17C 0x0407D12C
0x0096000A 0x032007EC 0x00000F7D 0x00020032 0x00000002 0x000001F4
0x025A07EC 0x02140ED3 0x00FFF000 0x00002002 0x0000040C 0x000A007F
0x00040810 0x00FBF40D 0x0000009E 0x00033D91 0x00007E65 0x00080000
0x1D87B200 0x1986B9C3 0x1555B182 0x1134A53F 0x0D33A0FD 0x0982ACBE
0x0641D086 0x03A11C55 0x01A08C2E 0x00703012 0x00000403 0x000012F6
0x000008C0 0x1D87B200 0x1986B9C3 0x1555B182 0x1134A53F 0x0D33A0FD
0x0982ACBE 0x0641D086 0x03A11C55 0x01A08C2E 0x00703012 0x00000403

// hdr: gra_ctrl l6
0x29 0x01 0x00 0x09 0x0026 0x007 0x0000000C 0xF1091000
0x050140C8 0x28140802 0x00080190 0x00042233 0x07AA0FA0

// hdr: tl_ctrl l6
0x29 0x01 0x00 0x09 0x0036 0x04A 0x0000000C 0xF1091014
0x1E77C1FA 0x1CC755DE 0x1B06E9C3 0x195679A7 0x17B60D8C 0x1605A572
0x14653D57 0x12D4D53E 0x11447124 0x0FC4110C 0x0E43B0F4 0x0CE354DD
0x0B82FCC6 0x0A32A8B1 0x0902589D 0x07D20C89 0x06C1C477 0x05B18066
0x04C14456 0x03E10C47 0x0320D83A 0x0260A82E 0x01D08023 0x01405C1A
0x00D03C12 0x0070240B 0x00301406 0x00100402 0x00000000 0x00000000
0x1C3755E7 0x18C679B0 0x1575A57B 0x1244D546 0x0F441114 0x0C6354E4
0x09D2A8B8 0x07720C90 0x0561806C 0x03A10C4C 0x0230A832 0x01205C1D
0x0060240D 0x00000403 0x00000000 0x00000000 0x00000000 0x00000000
0x00000000 0x00000000 0x00000000 0x00000000 0x00000000 0x00000000
0x00000000 0x00000000 0x00000000 0x00000000 0x00000000 0x00000400
0x00000400 0x0003EFBF 0x0003EFBE 0x0003DF7D 0x0000003C 0x00038EFF
0x00028BF2 0x0001E926 0x00000017 0x00000000 0x00000000 0x5A2DB058

// hdr: tm_ctrl l6
0x29 0x01 0x00 0x09 0x0046 0x035 0x0000000C 0xF1091134
0x01290000 0x0246018D 0x03980309 0x04CC040D 0x06670568 0x07EC0738
0x07EC07EC 0x000007EC 0x01290000 0x0246018D 0x03980309 0x04CC040D
0x06670568 0x07EC0738 0x07EC07EC 0x000007EC 0x032003E8 0x0032012C
0x00280028 0x00280028 0x00280028 0x00280028 0x00280028 0x040A0A02
0x10101000 0x10101010 0x00001010 0x0FFF0FFF 0x0080000C 0x07EC1A02
0x00000000 0x000001A8 0x00001001 0x00000000 0x00000000 0x00000000
0x00000000 0x00000000 0x00000000 0x00000000 0x00000000 0x00000000
0x00000000 0x00000000 0x00000000 0x00140100 0x00000002 0x00000883
0x00000080 0x0000021C 0x0100021C

// hdr: ratio_ctrl l6
0x29 0x01 0x00 0x09 0x0066 0x005 0x0000000C 0xF1091244
0x00001000 0x00001000 0x00000100

// hdr: col_ctrl l6
0x29 0x01 0x00 0x09 0x0076 0x00A 0x0000000C 0xF1091250
0x0000194D 0x00140678 0x00140763 0x00000CCC 0x00000CCC 0x00808080
0x00080000 0x00080000

// hdr: csc_ctrl l6
0x29 0x01 0x00 0x09 0x0096 0x04D 0x0000000C 0xF1091270
0x00000E38 0x00001278 0x00000C18 0x00001058 0x00000E38 0x00000E3C
0x00000D9B 0x00002DC6 0x0000049F 0x0000F8AB 0x0000E755 0x00002000
0x00002000 0x0000E2EF 0x0000FD11 0x00000000 0x00000000 0x00000000
0x0001A649 0x00016E2A 0x0000B8CF 0x0000D9BE 0x0002DC55 0x000049EC
0x000013CB 0x00007A0E 0x0003CD58 0x00000000 0x00000000 0x00000000
0x00000D9B 0x00002DC6 0x0000049F 0x000FF8AB 0x000FE755 0x00002000
0x00002000 0x000FE2EF 0x000FFD11 0x00000000 0x00002000 0x00002000
0x0000A09F 0x0000544C 0x00000B14 0x000011B0 0x0000EB68 0x000002E5
0x00000433 0x0000168A 0x0000E543 0x00000000 0x00000000 0x00000000
0x00004000 0x00000000 0x00000000 0x00000000 0x00004000 0x00000000
0x00000000 0x00000000 0x00004000 0x00004000 0x00000000 0x000064C9
0x00004000 0x0000F403 0x0000E20A 0x00004000 0x000076C2 0x00000000
0x00000000 0x00000000 0x00000000

// hdr: lut_ctrl l6
0x29 0x01 0x00 0x09 0x00A6 0x008 0x0000000C 0xF109139C
0x000000A8 0x000000A8 0x00000090 0x00000090 0x000000A8 0x00000090

// hdr: scurve_ctrl l6
0x29 0x01 0x00 0x09 0x00B6 0x00B 0x0000000C 0xF10913B4
0x00000000 0x00000000 0x00000040 0x0012C10E 0x000003E8 0x00200080
0x0000012C 0x00008000 0x00000000

// hdr: de_ctrl l6
0x29 0x01 0x00 0x09 0x00C6 0x020 0x0000000C 0xF10913D8
0x00040000 0x00805040 0x00008080 0x0000012A 0x000001D6 0x00000309
0x000007EC 0x00000FFF 0x00204080 0x00000010 0x00000062 0x000000DF
0x0000012A 0x0000018D 0x00000246 0x00064168 0x00801201 0x02E70C0C
0x001021C0 0x000000FF 0x0FFF4000 0x00004002 0x0FFF0FFF 0x20F7E12A
0x100FFC1E 0x08011850 0x01A80100 0x00080200 0x0066640A 0x0033320A

// hdr: top_ctrl l10
0x29 0x01 0x00 0x09 0x000A 0x00E 0x0000000C 0xF1090EF8
0x00107AB5 0x00064194 0x00000D7F 0x09240438 0x00000800 0x00000000
0x00000000 0x00000020 0x00200020 0x00000020 0x00000020 0x00000020

// hdr: lce_ctrl l10
0x29 0x01 0x00 0x09 0x001A 0x038 0x0000000C 0xF1090F28
0x00003011 0x04370000 0x09230000 0x001D40D8 0x00000100 0x001B00D8
0x00360288 0x003A81D4 0x0075057C 0x014C0100 0x0647095E 0x03CC0190
0x50501E32 0x01E007EC 0x01E00F7D 0x00020032 0x00000032 0x00000190
0x025A07EC 0x023C0ED3 0x00FFF000 0x00002002 0x0000040C 0x000A007F
0x00040810 0x00FBF40D 0x0000009E 0x00033D91 0x00007E65 0x00080000
0x1D87B200 0x1986B9C3 0x1555B182 0x1134A53F 0x0D33A0FD 0x0982ACBE
0x0641D086 0x03A11C55 0x01A08C2E 0x00703012 0x00000403 0x000012F6
0x000008C0 0x1D87B200 0x1986B9C3 0x1555B182 0x1134A53F 0x0D33A0FD
0x0982ACBE 0x0641D086 0x03A11C55 0x01A08C2E 0x00703012 0x00000403

// hdr: gra_ctrl l10
0x29 0x01 0x00 0x09 0x002A 0x007 0x0000000C 0xF1091000
0x050140C8 0x28140802 0x00080190 0x00042233 0x07AA0FA0

// hdr: tl_ctrl l10
0x29 0x01 0x00 0x09 0x003A 0x04A 0x0000000C 0xF1091014
0x1E77C1FA 0x1CC755DE 0x1B06E9C3 0x195679A7 0x17B60D8C 0x1605A572
0x14653D57 0x12D4D53E 0x11447124 0x0FC4110C 0x0E43B0F4 0x0CE354DD
0x0B82FCC6 0x0A32A8B1 0x0902589D 0x07D20C89 0x06C1C477 0x05B18066
0x04C14456 0x03E10C47 0x0320D83A 0x0260A82E 0x01D08023 0x01405C1A
0x00D03C12 0x0070240B 0x00301406 0x00100402 0x00000000 0x00000000
0x1C3755E7 0x18C679B0 0x1575A57B 0x1244D546 0x0F441114 0x0C6354E4
0x09D2A8B8 0x07720C90 0x0561806C 0x03A10C4C 0x0230A832 0x01205C1D
0x0060240D 0x00000403 0x00000000 0x00000000 0x00000000 0x00000000
0x00000000 0x00000000 0x00000000 0x00000000 0x00000000 0x00000000
0x00000000 0x00000000 0x00000000 0x00000000 0x00000000 0x00000400
0x00000400 0x0003EFBF 0x0003EFBE 0x0003DF7D 0x0000003C 0x00038EFF
0x00028BF2 0x0001E926 0x00000017 0x00000000 0x00000000 0x5A2DB058

// hdr: tm_ctrl l10
0x29 0x01 0x00 0x09 0x004A 0x035 0x0000000C 0xF1091134
0x01290000 0x0246018D 0x03980309 0x04CC040D 0x06670568 0x07EC0738
0x07EC07EC 0x000007EC 0x01290000 0x0246018D 0x03980309 0x04CC040D
0x06670568 0x07EC0738 0x07EC07EC 0x000007EC 0x032003E8 0x0032012C
0x00280028 0x00280028 0x00280028 0x00280028 0x00280028 0x040A0A02
0x10101000 0x10101010 0x00001010 0x0FFF0FFF 0x0080000C 0x07EC1A02
0x00000000 0x000001A8 0x00001001 0x00000000 0x00000000 0x00000000
0x00000000 0x00000000 0x00000000 0x00000000 0x00000000 0x00000000
0x00000000 0x00000000 0x00000000 0x00140100 0x00000002 0x00000883
0x00000080 0x0000021C 0x0100021C

// hdr: ratio_ctrl l10
0x29 0x01 0x00 0x09 0x006A 0x005 0x0000000C 0xF1091244
0x00001000 0x00001000 0x00000100

// hdr: col_ctrl l10
0x29 0x01 0x00 0x09 0x007A 0x00A 0x0000000C 0xF1091250
0x0000194D 0x00140678 0x00140763 0x00000CCC 0x00000CCC 0x0080803C
0x00080000 0x00080000

// hdr: csc_ctrl l10
0x29 0x01 0x00 0x09 0x009A 0x04D 0x0000000C 0xF1091270
0x00000E38 0x00001278 0x00000C18 0x00001058 0x00000E38 0x00000E3C
0x00000D9B 0x00002DC6 0x0000049F 0x0000F8AB 0x0000E755 0x00002000
0x00002000 0x0000E2EF 0x0000FD11 0x00000000 0x00000000 0x00000000
0x0001A649 0x00016E2A 0x0000B8CF 0x0000D9BE 0x0002DC55 0x000049EC
0x000013CB 0x00007A0E 0x0003CD58 0x00000000 0x00000000 0x00000000
0x00000D9B 0x00002DC6 0x0000049F 0x000FF8AB 0x000FE755 0x00002000
0x00002000 0x000FE2EF 0x000FFD11 0x00000000 0x00002000 0x00002000
0x0000A09F 0x0000544C 0x00000B14 0x000011B0 0x0000EB68 0x000002E5
0x00000433 0x0000168A 0x0000E543 0x00000000 0x00000000 0x00000000
0x00004000 0x00000000 0x00000000 0x00000000 0x00004000 0x00000000
0x00000000 0x00000000 0x00004000 0x00004000 0x00000000 0x000064C9
0x00004000 0x0000F403 0x0000E20A 0x00004000 0x000076C2 0x00000000
0x00000000 0x00000000 0x00000000

// hdr: lut_ctrl l10
0x29 0x01 0x00 0x09 0x00AA 0x008 0x0000000C 0xF109139C
0x000000A8 0x000000A8 0x00000090 0x00000090 0x000000A8 0x00000090

// hdr: scurve_ctrl l10
0x29 0x01 0x00 0x09 0x00BA 0x00B 0x0000000C 0xF10913B4
0x00000000 0x00000000 0x00000040 0x0010E118 0x00000190 0x00200080
0x0000012C 0x00008000 0x00000000

// hdr: de_ctrl l10
0x29 0x01 0x00 0x09 0x00CA 0x020 0x0000000C 0xF10913D8
0x00040000 0x00804020 0x00008080 0x0000012A 0x000001D6 0x00000309
0x000007EC 0x00000FFF 0x00204080 0x00000010 0x00000062 0x000000DF
0x0000012A 0x0000018D 0x00000246 0x000500F0 0x00801201 0x01BB0C0C
0x001021C0 0x000000FF 0x0FFF4000 0x00004002 0x0FFF0FFF 0x10F7E12A
0x100FFC1E 0x08011850 0x01A80100 0x00080200 0x0066640A 0x0033320A

// hdr: top_ctrl l11
0x29 0x01 0x00 0x09 0x000B 0x00E 0x0000000C 0xF1090EF8
0x00107AB5 0x00064114 0x00000D7F 0x09240438 0x00000800 0x00000000
0x00000000 0x00000020 0x00200020 0x00000020 0x00000020 0x00000020

// hdr: lce_ctrl l11
0x29 0x01 0x00 0x09 0x001B 0x038 0x0000000C 0xF1090F28
0x00003011 0x04370000 0x09230000 0x001D40D8 0x00000100 0x001B00D8
0x00360288 0x003A81D4 0x0075057C 0x0287D1F4 0x0647D17C 0x0407D12C
0x0096000A 0x032007EC 0x00000F7D 0x00020032 0x00000032 0x000001F4
0x025A07EC 0x02140ED3 0x00FFF000 0x00002002 0x0000040C 0x000A007F
0x00040810 0x00FBF40D 0x0000009E 0x00033D91 0x00007E65 0x00080000
0x1D87B200 0x1986B9C3 0x1555B182 0x1134A53F 0x0D33A0FD 0x0982ACBE
0x0641D086 0x03A11C55 0x01A08C2E 0x00703012 0x00000403 0x000012F6
0x000008C0 0x1D87B200 0x1986B9C3 0x1555B182 0x1134A53F 0x0D33A0FD
0x0982ACBE 0x0641D086 0x03A11C55 0x01A08C2E 0x00703012 0x00000403

// hdr: gra_ctrl l11
0x29 0x01 0x00 0x09 0x002B 0x007 0x0000000C 0xF1091000
0x050140C8 0x28140802 0x00080190 0x00042233 0x07AA0FA0

// hdr: tl_ctrl l11
0x29 0x01 0x00 0x09 0x003B 0x04A 0x0000000C 0xF1091014
0x1E77C1FA 0x1CC755DE 0x1B06E9C3 0x195679A7 0x17B60D8C 0x1605A572
0x14653D57 0x12D4D53E 0x11447124 0x0FC4110C 0x0E43B0F4 0x0CE354DD
0x0B82FCC6 0x0A32A8B1 0x0902589D 0x07D20C89 0x06C1C477 0x05B18066
0x04C14456 0x03E10C47 0x0320D83A 0x0260A82E 0x01D08023 0x01405C1A
0x00D03C12 0x0070240B 0x00301406 0x00100402 0x00000000 0x00000000
0x1C3755E7 0x18C679B0 0x1575A57B 0x1244D546 0x0F441114 0x0C6354E4
0x09D2A8B8 0x07720C90 0x0561806C 0x03A10C4C 0x0230A832 0x01205C1D
0x0060240D 0x00000403 0x00000000 0x00000000 0x00000000 0x00000000
0x00000000 0x00000000 0x00000000 0x00000000 0x00000000 0x00000000
0x00000000 0x00000000 0x00000000 0x00000000 0x00000000 0x00000400
0x00000400 0x0003EFBF 0x0003EFBE 0x0003DF7D 0x0000003C 0x00038EFF
0x00028BF2 0x0001E926 0x00000017 0x00000000 0x00000000 0x5A2DB058

// hdr: tm_ctrl l11
0x29 0x01 0x00 0x09 0x004B 0x035 0x0000000C 0xF1091134
0x00000000 0x02460129 0x062C04CC 0x09A2083E 0x0D5A0BFB 0x0FDF0E8C
0x0FFF0FFF 0x00000FFF 0x00000000 0x02460129 0x062C04CC 0x09A2083E
0x0D5A0BFB 0x0FDF0E8C 0x0FFF0FFF 0x00000FFF 0x032003E8 0x0032012C
0x00280028 0x00280028 0x00280028 0x00280028 0x00280028 0x040A0A02
0x10101000 0x10101010 0x00001010 0x0FFF0FFF 0x0080000C 0x07EC1A02
0x00000000 0x000001A8 0x00001001 0x00000000 0x00000000 0x00000000
0x00000000 0x00000000 0x00000000 0x00000000 0x00000000 0x00000000
0x00000000 0x00000000 0x00000000 0x00C80100 0x0000007A 0x00000883
0x00000080 0x0000021C 0x0100021C

// hdr: ratio_ctrl l11
0x29 0x01 0x00 0x09 0x006B 0x005 0x0000000C 0xF1091244
0x00001000 0x00001000 0x00000100

// hdr: col_ctrl l11
0x29 0x01 0x00 0x09 0x007B 0x00A 0x0000000C 0xF1091250
0x0000194D 0x00140678 0x00140763 0x00000CCC 0x00000CCC 0x00808080
0x00080000 0x00080000

// hdr: csc_ctrl l11
0x29 0x01 0x00 0x09 0x009B 0x04D 0x0000000C 0xF1091270
0x00000E38 0x00001278 0x00000C18 0x00001058 0x00000E38 0x00000E3C
0x00000D9B 0x00002DC6 0x0000049F 0x0000F8AB 0x0000E755 0x00002000
0x00002000 0x0000E2EF 0x0000FD11 0x00000000 0x00000000 0x00000000
0x0001A649 0x00016E2A 0x0000B8CF 0x0000D9BE 0x0002DC55 0x000049EC
0x000013CB 0x00007A0E 0x0003CD58 0x00000000 0x00000000 0x00000000
0x00000D9B 0x00002DC6 0x0000049F 0x000FF8AB 0x000FE755 0x00002000
0x00002000 0x000FE2EF 0x000FFD11 0x00000000 0x00002000 0x00002000
0x0000A09F 0x0000544C 0x00000B14 0x000011B0 0x0000EB68 0x000002E5
0x00000433 0x0000168A 0x0000E543 0x00000000 0x00000000 0x00000000
0x00004000 0x00000000 0x00000000 0x00000000 0x00004000 0x00000000
0x00000000 0x00000000 0x00004000 0x00004000 0x00000000 0x000064C9
0x00004000 0x0000F403 0x0000E20A 0x00004000 0x000076C2 0x00000000
0x00000000 0x00000000 0x00000000

// hdr: lut_ctrl l11
0x29 0x01 0x00 0x09 0x00AB 0x008 0x0000000C 0xF109139C
0x000000A8 0x000000A8 0x00000090 0x00000090 0x000000A8 0x00000090

// hdr: scurve_ctrl l11
0x29 0x01 0x00 0x09 0x00BB 0x00B 0x0000000C 0xF10913B4
0x00000000 0x00000000 0x00000040 0x0012C136 0x000003E8 0x00200080
0x0000012C 0x00008000 0x00000000

// hdr: de_ctrl l11
0x29 0x01 0x00 0x09 0x00CB 0x020 0x0000000C 0xF10913D8
0x00040000 0x00805040 0x00008080 0x0000012A 0x000001D6 0x00000309
0x000007EC 0x00000FFF 0x00204080 0x00000010 0x00000062 0x000000DF
0x0000012A 0x0000018D 0x00000246 0x00064168 0x00801201 0x02E70C0C
0x001021C0 0x000000FF 0x0FFF4000 0x00004002 0x0FFF0FFF 0x20F7E12A
0x100FFC1E 0x08011850 0x01A80100 0x00080200 0x0066640A 0x0033320A

// hdr: top_ctrl l12
0x29 0x01 0x00 0x09 0x000C 0x00E 0x0000000C 0xF1090EF8
0x00107AB5 0x00064184 0x00000D3F 0x09240438 0x00000800 0x00000000
0x00000000 0x00000020 0x00200020 0x00000020 0x00000020 0x00000020

// hdr: lce_ctrl l12
0x29 0x01 0x00 0x09 0x001C 0x038 0x0000000C 0xF1090F28
0x00003001 0x04370000 0x09230000 0x001D40D8 0x00000100 0x001B00D8
0x00360288 0x003A81D4 0x0075057C 0x028320C8 0x0467D17C 0x0197D12C
0x00963232 0x0C800961 0x000013CA 0x00020014 0x00000002 0x000003FF
0x02140F7D 0x020A0000 0x00FFF000 0x00002002 0x0000040C 0x000A007F
0x00040810 0x00FDF309 0x0000009E 0x00033D91 0x0000A8B0 0x00100000
0x1D87B200 0x1986B9C3 0x1555B182 0x1134A53F 0x0D33A0FD 0x0982ACBE
0x0641D086 0x03A11C55 0x01A08C2E 0x00703012 0x00000403 0x000012F6
0x000008C0 0x1D87B200 0x1986B9C3 0x1555B182 0x1134A53F 0x0D33A0FD
0x0982ACBE 0x0641D086 0x03A11C55 0x01A08C2E 0x00703012 0x00000403

// hdr: gra_ctrl l12
0x29 0x01 0x00 0x09 0x002C 0x007 0x0000000C 0xF1091000
0x05014FFF 0x28140802 0x00080190 0x00042233 0x07AA0FA0

// hdr: tl_ctrl l12
0x29 0x01 0x00 0x09 0x003C 0x04A 0x0000000C 0xF1091014
0x1E77C1FA 0x1CC755DE 0x1B06E9C3 0x195679A7 0x17B60D8C 0x1605A572
0x14653D57 0x12D4D53E 0x11447124 0x0FC4110C 0x0E43B0F4 0x0CE354DD
0x0B82FCC6 0x0A32A8B1 0x0902589D 0x07D20C89 0x06C1C477 0x05B18066
0x04C14456 0x03E10C47 0x0320D83A 0x0260A82E 0x01D08023 0x01405C1A
0x00D03C12 0x0070240B 0x00301406 0x00100402 0x00000000 0x00000000
0x1C3755E7 0x18C679B0 0x1575A57B 0x1244D546 0x0F441114 0x0C6354E4
0x09D2A8B8 0x07720C90 0x0561806C 0x03A10C4C 0x0230A832 0x01205C1D
0x0060240D 0x00000403 0x00000000 0x00000000 0x00000000 0x00000000
0x00000000 0x00000000 0x00000000 0x00000000 0x00000000 0x00000000
0x00000000 0x00000000 0x00000000 0x00000000 0x00000000 0x00000400
0x00000400 0x0003EFBF 0x0003EFBE 0x0003DF7D 0x0000003C 0x00038EFF
0x00028BF2 0x0001E926 0x00000017 0x00000000 0x00000000 0x5A2DB058

// hdr: tm_ctrl l12
0x29 0x01 0x00 0x09 0x004C 0x035 0x0000000C 0xF1091134
0x01290000 0x0246018D 0x03980309 0x04CC040D 0x06670568 0x07EC0738
0x07EC07EC 0x000007EC 0x01290000 0x0246018D 0x03980309 0x04CC040D
0x06670568 0x07EC0738 0x07EC07EC 0x000007EC 0x032003E8 0x0032012C
0x00280028 0x00280028 0x00280028 0x00280028 0x00280028 0x040A0A02
0x10101000 0x10101010 0x00001010 0x0FFF0FFF 0x0080000C 0x07EC1A02
0x00000000 0x000001A8 0x00001001 0x00000000 0x00000000 0x00000000
0x00000000 0x00000000 0x00000000 0x00000000 0x00000000 0x00000000
0x00000000 0x00000000 0x00000000 0x00140100 0x00000002 0x00000883
0x00000080 0x0000021C 0x0100021C

// hdr: ratio_ctrl l12
0x29 0x01 0x00 0x09 0x006C 0x005 0x0000000C 0xF1091244
0x00001000 0x00001000 0x00000100

// hdr: col_ctrl l12
0x29 0x01 0x00 0x09 0x007C 0x00A 0x0000000C 0xF1091250
0x0000194D 0x00140678 0x00140763 0x00000CCC 0x00000CCC 0x00808080
0x00080000 0x00080000

// hdr: csc_ctrl l12
0x29 0x01 0x00 0x09 0x009C 0x04D 0x0000000C 0xF1091270
0x00000E38 0x00001278 0x00000C18 0x00001058 0x00000E38 0x00000E3C
0x00000D9B 0x00002DC6 0x0000049F 0x0000F8AB 0x0000E755 0x00002000
0x00002000 0x0000E2EF 0x0000FD11 0x00000000 0x00000000 0x00000000
0x0001A649 0x00016E2A 0x0000B8CF 0x0000D9BE 0x0002DC55 0x000049EC
0x000013CB 0x00007A0E 0x0003CD58 0x00000000 0x00000000 0x00000000
0x00000D9B 0x00002DC6 0x0000049F 0x000FF8AB 0x000FE755 0x00002000
0x00002000 0x000FE2EF 0x000FFD11 0x00000000 0x00002000 0x00002000
0x0000A09F 0x0000544C 0x00000B14 0x000011B0 0x0000EB68 0x000002E5
0x00000433 0x0000168A 0x0000E543 0x00000000 0x00000000 0x00000000
0x00004000 0x00000000 0x00000000 0x00000000 0x00004000 0x00000000
0x00000000 0x00000000 0x00004000 0x00004000 0x00000000 0x000064C9
0x00004000 0x0000F403 0x0000E20A 0x00004000 0x000076C2 0x00000000
0x00000000 0x00000000 0x00000000

// hdr: lut_ctrl l12
0x29 0x01 0x00 0x09 0x00AC 0x008 0x0000000C 0xF109139C
0x000000A8 0x000000A8 0x00000090 0x00000090 0x000000A8 0x00000090

// hdr: scurve_ctrl l12
0x29 0x01 0x00 0x09 0x00BC 0x00B 0x0000000C 0xF10913B4
0x00000000 0x00000000 0x00000040 0x00140118 0x00000190 0x00200080
0x0000012C 0x00008000 0x000003E8

// hdr: de_ctrl l12
0x29 0x01 0x00 0x09 0x00CC 0x020 0x0000000C 0xF10913D8
0x00040000 0x00645040 0x00008080 0x0000012A 0x0000018D 0x00000309
0x00000667 0x000007EC 0x00408080 0x00000020 0x0000001A 0x00000062
0x0000012A 0x0000018D 0x00000246 0x00050168 0x00801201 0x016B0C0C
0x001021C0 0x000000FF 0x0FFF2800 0x00004002 0x0FFF0FFF 0x1079512A
0x1003E81E 0x08012C50 0x01A80100 0x00080200 0x0066640A 0x0033320A

// hdr: top_ctrl l7
0x29 0x01 0x00 0x09 0x0007 0x00E 0x0000000C 0xF1090EF8
0x00107AB5 0x00064194 0x00000D7F 0x09240438 0x00000800 0x00000000
0x00000000 0x00000020 0x00200020 0x00000020 0x00000020 0x00000020

// hdr: lce_ctrl l7
0x29 0x01 0x00 0x09 0x0017 0x038 0x0000000C 0xF1090F28
0x00003011 0x04370000 0x09230000 0x001D40D8 0x00000100 0x001B00D8
0x00360288 0x003A81D4 0x0075057C 0x0287D1F4 0x0647D17C 0x0407D12C
0x0096000A 0x032007EC 0x00000F7D 0x00020032 0x00000002 0x000001F4
0x025A07EC 0x02140ED3 0x00FFF000 0x00002002 0x0000040C 0x000A007F
0x00040810 0x00FBF40D 0x0000009E 0x00033D91 0x00007E65 0x00080000
0x1D87B200 0x1986B9C3 0x1555B182 0x1134A53F 0x0D33A0FD 0x0982ACBE
0x0641D086 0x03A11C55 0x01A08C2E 0x00703012 0x00000403 0x000012F6
0x000008C0 0x1D87B200 0x1986B9C3 0x1555B182 0x1134A53F 0x0D33A0FD
0x0982ACBE 0x0641D086 0x03A11C55 0x01A08C2E 0x00703012 0x00000403

// hdr: gra_ctrl l7
0x29 0x01 0x00 0x09 0x0027 0x007 0x0000000C 0xF1091000
0x050140C8 0x28140802 0x00080190 0x00042233 0x07AA0FA0

// hdr: tl_ctrl l7
0x29 0x01 0x00 0x09 0x0037 0x04A 0x0000000C 0xF1091014
0x1E77C1FA 0x1CC755DE 0x1B06E9C3 0x195679A7 0x17B60D8C 0x1605A572
0x14653D57 0x12D4D53E 0x11447124 0x0FC4110C 0x0E43B0F4 0x0CE354DD
0x0B82FCC6 0x0A32A8B1 0x0902589D 0x07D20C89 0x06C1C477 0x05B18066
0x04C14456 0x03E10C47 0x0320D83A 0x0260A82E 0x01D08023 0x01405C1A
0x00D03C12 0x0070240B 0x00301406 0x00100402 0x00000000 0x00000000
0x1C3755E7 0x18C679B0 0x1575A57B 0x1244D546 0x0F441114 0x0C6354E4
0x09D2A8B8 0x07720C90 0x0561806C 0x03A10C4C 0x0230A832 0x01205C1D
0x0060240D 0x00000403 0x00000000 0x00000000 0x00000000 0x00000000
0x00000000 0x00000000 0x00000000 0x00000000 0x00000000 0x00000000
0x00000000 0x00000000 0x00000000 0x00000000 0x00000000 0x00000400
0x00000400 0x0003EFBF 0x0003EFBE 0x0003DF7D 0x0000003C 0x00038EFF
0x00028BF2 0x0001E926 0x00000017 0x00000000 0x00000000 0x5A2DB058

// hdr: tm_ctrl l7
0x29 0x01 0x00 0x09 0x0047 0x035 0x0000000C 0xF1091134
0x01290000 0x0246018D 0x03980309 0x04CC040D 0x06670568 0x07EC0738
0x07EC07EC 0x000007EC 0x01290000 0x0246018D 0x03980309 0x04CC040D
0x06670568 0x07EC0738 0x07EC07EC 0x000007EC 0x032003E8 0x0032012C
0x00280028 0x00280028 0x00280028 0x00280028 0x00280028 0x040A0A02
0x10101000 0x10101010 0x00001010 0x0FFF0FFF 0x0080000C 0x07EC1A02
0x00000000 0x000001A8 0x00001001 0x00000000 0x00000000 0x00000000
0x00000000 0x00000000 0x00000000 0x00000000 0x00000000 0x00000000
0x00000000 0x00000000 0x00000000 0x00140100 0x00000002 0x00000883
0x00000080 0x0000021C 0x0100021C

// hdr: ratio_ctrl l7
0x29 0x01 0x00 0x09 0x0067 0x005 0x0000000C 0xF1091244
0x00001000 0x00001000 0x00000100

// hdr: col_ctrl l7
0x29 0x01 0x00 0x09 0x0077 0x00A 0x0000000C 0xF1091250
0x0000194D 0x00140678 0x00140763 0x00000CCC 0x00000CCC 0x00808080
0x00080000 0x00080000

// hdr: csc_ctrl l7
0x29 0x01 0x00 0x09 0x0097 0x04D 0x0000000C 0xF1091270
0x00000E38 0x00001278 0x00000C18 0x00001058 0x00000E38 0x00000E3C
0x00000D9B 0x00002DC6 0x0000049F 0x0000F8AB 0x0000E755 0x00002000
0x00002000 0x0000E2EF 0x0000FD11 0x00000000 0x00000000 0x00000000
0x0001A649 0x00016E2A 0x0000B8CF 0x0000D9BE 0x0002DC55 0x000049EC
0x000013CB 0x00007A0E 0x0003CD58 0x00000000 0x00000000 0x00000000
0x00000D9B 0x00002DC6 0x0000049F 0x000FF8AB 0x000FE755 0x00002000
0x00002000 0x000FE2EF 0x000FFD11 0x00000000 0x00002000 0x00002000
0x0000A09F 0x0000544C 0x00000B14 0x000011B0 0x0000EB68 0x000002E5
0x00000433 0x0000168A 0x0000E543 0x00000000 0x00000000 0x00000000
0x00004000 0x00000000 0x00000000 0x00000000 0x00004000 0x00000000
0x00000000 0x00000000 0x00004000 0x00004000 0x00000000 0x000064C9
0x00004000 0x0000F403 0x0000E20A 0x00004000 0x000076C2 0x00000000
0x00000000 0x00000000 0x00000000

// hdr: lut_ctrl l7
0x29 0x01 0x00 0x09 0x00A7 0x008 0x0000000C 0xF109139C
0x000000A8 0x000000A8 0x00000090 0x00000090 0x000000A8 0x00000090

// hdr: scurve_ctrl l7
0x29 0x01 0x00 0x09 0x00B7 0x00B 0x0000000C 0xF10913B4
0x00000000 0x00000000 0x00000040 0x0012C10E 0x000003E8 0x00200080
0x0000012C 0x00008000 0x00000000

// hdr: de_ctrl l7
0x29 0x01 0x00 0x09 0x00C7 0x020 0x0000000C 0xF10913D8
0x00040000 0x00805040 0x00008080 0x0000012A 0x000001D6 0x00000309
0x000007EC 0x00000FFF 0x00204080 0x00000010 0x00000062 0x000000DF
0x0000012A 0x0000018D 0x00000246 0x00064168 0x00801201 0x02E70C0C
0x001021C0 0x000000FF 0x0FFF4000 0x00004002 0x0FFF0FFF 0x20F7E12A
0x100FFC1E 0x08011850 0x01A80100 0x00080200 0x0066640A 0x0033320A

// hdr: top_ctrl l13
0x29 0x01 0x00 0x09 0x000D 0x00E 0x0000000C 0xF1090EF8
0x00107AB5 0x000753D4 0x00000D3F 0x09240438 0x00000800 0x00000000
0x00000000 0x00000020 0x00200020 0x00000020 0x00000020 0x00000020

// hdr: lce_ctrl l13
0x29 0x01 0x00 0x09 0x001D 0x038 0x0000000C 0xF1090F28
0x00003001 0x04370000 0x09230000 0x001D40D8 0x00000100 0x001B00D8
0x00360288 0x003A81D4 0x0075057C 0x028320C8 0x0467D17C 0x0197D12C
0x00963232 0x0C800961 0x000013CA 0x00020014 0x00000002 0x000003FF
0x02140F7D 0x020A0000 0x00FFF000 0x00002002 0x0000040C 0x000A007F
0x00040810 0x00FDF309 0x0000009E 0x00033D91 0x0000A8B0 0x00100000
0x1D87B200 0x1986B9C3 0x1555B182 0x1134A53F 0x0D33A0FD 0x0982ACBE
0x0641D086 0x03A11C55 0x01A08C2E 0x00703012 0x00000403 0x000012F6
0x000008C0 0x1D87B200 0x1986B9C3 0x1555B182 0x1134A53F 0x0D33A0FD
0x0982ACBE 0x0641D086 0x03A11C55 0x01A08C2E 0x00703012 0x00000403

// hdr: gra_ctrl l13
0x29 0x01 0x00 0x09 0x002D 0x007 0x0000000C 0xF1091000
0x05014FFF 0x28140802 0x00080190 0x00042233 0x07AA0FA0

// hdr: tl_ctrl l13
0x29 0x01 0x00 0x09 0x003D 0x04A 0x0000000C 0xF1091014
0x1E77C1FA 0x1CC755DE 0x1B06E9C3 0x195679A7 0x17B60D8C 0x1605A572
0x14653D57 0x12D4D53E 0x11447124 0x0FC4110C 0x0E43B0F4 0x0CE354DD
0x0B82FCC6 0x0A32A8B1 0x0902589D 0x07D20C89 0x06C1C477 0x05B18066
0x04C14456 0x03E10C47 0x0320D83A 0x0260A82E 0x01D08023 0x01405C1A
0x00D03C12 0x0070240B 0x00301406 0x00100402 0x00000000 0x00000000
0x1C3755E7 0x18C679B0 0x1575A57B 0x1244D546 0x0F441114 0x0C6354E4
0x09D2A8B8 0x07720C90 0x0561806C 0x03A10C4C 0x0230A832 0x01205C1D
0x0060240D 0x00000403 0x00000000 0x00000000 0x00000000 0x00000000
0x00000000 0x00000000 0x00000000 0x00000000 0x00000000 0x00000000
0x00000000 0x00000000 0x00000000 0x00000000 0x00000000 0x00000400
0x00000400 0x0003EFBF 0x0003EFBE 0x0003DF7D 0x0000003C 0x00038EFF
0x00028BF2 0x0001E926 0x00000017 0x00000000 0x00000000 0x5A2DB058

// hdr: tm_ctrl l13
0x29 0x01 0x00 0x09 0x004D 0x035 0x0000000C 0xF1091134
0x01290000 0x0246018D 0x03980309 0x04CC040D 0x06670568 0x07EC0738
0x07EC07EC 0x000007EC 0x01290000 0x0246018D 0x03980309 0x04CC040D
0x06670568 0x07EC0738 0x07EC07EC 0x000007EC 0x032003E8 0x0032012C
0x00280028 0x00280028 0x00280028 0x00280028 0x00280028 0x040A0A02
0x10101000 0x10101010 0x00001010 0x0FFF0FFF 0x0080000C 0x07EC1A02
0x00000000 0x000001A8 0x00001001 0x00000000 0x00000000 0x00000000
0x00000000 0x00000000 0x00000000 0x00000000 0x00000000 0x00000000
0x00000000 0x00000000 0x00000000 0x00140100 0x00000002 0x00000883
0x00000080 0x0000021C 0x0100021C

// hdr: ratio_ctrl l13
0x29 0x01 0x00 0x09 0x006D 0x005 0x0000000C 0xF1091244
0x00001000 0x00001000 0x00000100

// hdr: col_ctrl l13
0x29 0x01 0x00 0x09 0x007D 0x00A 0x0000000C 0xF1091250
0x0000194D 0x00140678 0x00140763 0x00000CCC 0x00000CCC 0x00808080
0x00080000 0x00080000

// hdr: csc_ctrl l13
0x29 0x01 0x00 0x09 0x009D 0x04D 0x0000000C 0xF1091270
0x00000E38 0x00001278 0x00000C18 0x00001058 0x00000E38 0x00000E3C
0x00000D9B 0x00002DC6 0x0000049F 0x0000F8AB 0x0000E755 0x00002000
0x00002000 0x0000E2EF 0x0000FD11 0x00000000 0x00000000 0x00000000
0x0001A649 0x00016E2A 0x0000B8CF 0x0000D9BE 0x0002DC55 0x000049EC
0x000013CB 0x00007A0E 0x0003CD58 0x00000000 0x00000000 0x00000000
0x00000D9B 0x00002DC6 0x0000049F 0x000FF8AB 0x000FE755 0x00002000
0x00002000 0x000FE2EF 0x000FFD11 0x00000000 0x00002000 0x00002000
0x0000A09F 0x0000544C 0x00000B14 0x000011B0 0x0000EB68 0x000002E5
0x00000433 0x0000168A 0x0000E543 0x00000000 0x00000000 0x00000000
0x00004000 0x00000000 0x00000000 0x00000000 0x00004000 0x00000000
0x00000000 0x00000000 0x00004000 0x00004000 0x00000000 0x000064C9
0x00004000 0x0000F403 0x0000E20A 0x00004000 0x000076C2 0x00000000
0x00000000 0x00000000 0x00000000

// hdr: lut_ctrl l13
0x29 0x01 0x00 0x09 0x00AD 0x008 0x0000000C 0xF109139C
0x000000A8 0x000000A8 0x00000090 0x00000090 0x000000A8 0x00000090

// hdr: scurve_ctrl l13
0x29 0x01 0x00 0x09 0x00BD 0x00B 0x0000000C 0xF10913B4
0x00000000 0x00000000 0x00000040 0x00140118 0x00000190 0x00200080
0x0000012C 0x00008000 0x000003E8

// hdr: de_ctrl l13
0x29 0x01 0x00 0x09 0x00CD 0x020 0x0000000C 0xF10913D8
0x00040000 0x00645040 0x00008080 0x0000012A 0x0000018D 0x00000309
0x00000667 0x000007EC 0x00408080 0x00000020 0x0000001A 0x00000062
0x0000012A 0x0000018D 0x00000246 0x00050168 0x00801201 0x016B0C0C
0x001021C0 0x000000FF 0x0FFF2800 0x00004002 0x0FFF0FFF 0x1079512A
0x1003E81E 0x08012C50 0x01A80100 0x00080200 0x0066640A 0x0033320A

// hdr: top_ctrl l4
0x29 0x01 0x00 0x09 0x0004 0x00E 0x0000000C 0xF1090EF8
0x0010B00B 0x00021350 0x000014F0 0x09240438 0x00000800 0x00000000
0x00000000 0x00000020 0x00200020 0x00000020 0x00000020 0x00000020

// hdr: lce_ctrl l4
0x29 0x01 0x00 0x09 0x0014 0x038 0x0000000C 0xF1090F28
0x00003001 0x04370000 0x09230000 0x001D40D8 0x00000100 0x001B00D8
0x00360288 0x003A81D4 0x0075057C 0x0287D1F4 0x0467D17C 0x0197D12C
0x00960000 0x0C8008C9 0x00000BD7 0x00020014 0x00000002 0x000003FF
0x02640AD2 0x020A0000 0x00AF4000 0x00002EBE 0x0000040C 0x000A0057
0x0005E293 0x00AEC4CB 0x0000006B 0x0004C8F8 0x00006AD2 0x00400000
0x1D87B200 0x1986B9C3 0x1555B182 0x1134A53F 0x0D33A0FD 0x0982ACBE
0x0641D086 0x03A11C55 0x01A08C2E 0x00703012 0x00000403 0x000012F6
0x000008C0 0x1D87B200 0x1986B9C3 0x1555B182 0x1134A53F 0x0D33A0FD
0x0982ACBE 0x0641D086 0x03A11C55 0x01A08C2E 0x00703012 0x00000403

// hdr: gra_ctrl l4
0x29 0x01 0x00 0x09 0x0024 0x007 0x0000000C 0xF1091000
0x05014FFF 0x28140802 0x00080190 0x00042233 0x07AA0FA0

// hdr: tl_ctrl l4
0x29 0x01 0x00 0x09 0x0034 0x04A 0x0000000C 0xF1091014
0x1C3755E7 0x18C679B0 0x1575A57B 0x1244D546 0x0F441114 0x0C6354E4
0x09D2A8B8 0x07720C90 0x0561806C 0x03A10C4C 0x0230A832 0x01205C1D
0x0060240D 0x00000403 0x00000000 0x00000000 0x00000000 0x00000000
0x00000000 0x00000000 0x00000000 0x00000000 0x00000000 0x00000000
0x00000000 0x00000000 0x00000000 0x00000000 0x00000000 0x00000000
0x18C6C1D5 0x12451969 0x0C639104 0x077240AA 0x03A13060 0x0120742A
0x00000C09 0x00000800 0x00000000 0x00000000 0x00000000 0x00000000
0x00000000 0x00000000 0x00000000 0x00000000 0x00000000 0x00000000
0x00000000 0x00000000 0x00000000 0x00000000 0x00000000 0x00000000
0x00000000 0x00000000 0x00000000 0x00000000 0x00000000 0x00000400
0x00000400 0x0003EFBF 0x0003EFBE 0x0003DF7D 0x0000003C 0x00038EFF
0x00028BF2 0x0001E926 0x00000017 0x00000000 0x00000000 0x2E175A2D

// hdr: tm_ctrl l4
0x29 0x01 0x00 0x09 0x0044 0x035 0x0000000C 0xF1091134
0x04CB0000 0x08E407F5 0x09F2097F 0x0AD20A70 0x0B860B23 0x0C060BD7
0x0CBB0C58 0x00000FFF 0x04CB0000 0x08E407F5 0x09F2097F 0x0AD20A70
0x0B860B23 0x0C060BD7 0x0CBB0C58 0x00000FFF 0x02580578 0x01900258
0x01900190 0x01900190 0x01900190 0x01900190 0x00140190 0x04080802
0x04040404 0x02040404 0x00000202 0x0FFF0FFF 0x00FA0001 0x08201A03
0x00000000 0x000001A8 0x00001001 0x00000000 0x00000000 0x00000000
0x00000000 0x00000000 0x00000000 0x00000000 0x00000000 0x00000000
0x00000000 0x00000000 0x00000000 0x00140100 0x00000004 0x00000D66
0x00000080 0x00002710 0x01002710

// hdr: ratio_ctrl l4
0x29 0x01 0x00 0x09 0x0064 0x005 0x0000000C 0xF1091244
0x00001000 0x00001000 0x00000100

// hdr: col_ctrl l4
0x29 0x01 0x00 0x09 0x0074 0x00A 0x0000000C 0xF1091250
0x0000197D 0x0014060F 0x001406EF 0x00000CCC 0x00000CCC 0x00808080
0x00080000 0x00080000

// hdr: csc_ctrl l4
0x29 0x01 0x00 0x09 0x0094 0x04D 0x0000000C 0xF1091270
0x00000E38 0x00001278 0x00000C18 0x00001058 0x00000E38 0x00000E38
0x00004000 0x00000000 0x00000000 0x00000000 0x00004000 0x00000000
0x00000000 0x00000000 0x00004000 0x00000000 0x00000000 0x00000000
0x00028C3E 0x00009416 0x0000ACEF 0x00010D01 0x0002B645 0x00003CB9
0x00000000 0x00001CBF 0x00043E72 0x00000000 0x00000000 0x00000000
0x00000D9B 0x00002DC6 0x0000049F 0x000FF8AB 0x000FE755 0x00002000
0x00002000 0x000FE2EF 0x000FFD11 0x00000000 0x00002000 0x00002000
0x0000A09F 0x0000544C 0x00000B14 0x000011B0 0x0000EB68 0x000002E5
0x00000433 0x0000168A 0x0000E543 0x00000000 0x00000000 0x00000000
0x00004000 0x00000000 0x00000000 0x00000000 0x00004000 0x00000000
0x00000000 0x00000000 0x00004000 0x00004000 0x0000008D 0x0000071B
0x00004000 0x0000FF73 0x0000F8E5 0x00004000 0x000023D7 0x0000EB7B
0x00000000 0x00000000 0x00000000

// hdr: lut_ctrl l4
0x29 0x01 0x00 0x09 0x00A4 0x008 0x0000000C 0xF109139C
0x000000A8 0x000000A8 0x00000090 0x00000090 0x000000A8 0x00000090

// hdr: scurve_ctrl l4
0x29 0x01 0x00 0x09 0x00B4 0x00B 0x0000000C 0xF10913B4
0x00000000 0x00000000 0x00000040 0x00100100 0x00000190 0x00200080
0x0000012C 0x00008000 0x00000000

// hdr: de_ctrl l4
0x29 0x01 0x00 0x09 0x00C4 0x020 0x0000000C 0xF10913D8
0x00040000 0x00645040 0x00008080 0x00000266 0x00000303 0x000004CB
0x00000752 0x00000821 0x00408080 0x00000020 0x0000002F 0x000000DB
0x00000266 0x00000303 0x000003F7 0x00050168 0x00801201 0x016B0C0C
0x001021C0 0x000000FF 0x0FFF2800 0x00004002 0x0FFF0FFF 0x1082E058
0x1003E81E 0x08012C50 0x01A80100 0x00080200 0x0066640A 0x0033320A

// hdr: tm_sw_cfg l4
0x29 0x01 0x00 0x09 0x0054 0x013 0x0000000C 0xF1091200
0x04CB0000 0x08E407F5 0x09F2097F 0x0AD20A70 0x0B860B23 0x0C060BD7
0x0CBB0C58 0x00000FFF 0x04CB0000 0x08E407F5 0x09F2097F 0x0AD20A70
0x0B860B23 0x0C060BD7 0x0CBB0C58 0x00000FFF 0x00000000

// hdr: top_ctrl l8
0x29 0x01 0x00 0x09 0x0008 0x00E 0x0000000C 0xF1090EF8
0x00107AB5 0x00064194 0x00000D7F 0x09240438 0x00000800 0x00000000
0x00000000 0x00000020 0x00200020 0x00000020 0x00000020 0x00000020

// hdr: lce_ctrl l8
0x29 0x01 0x00 0x09 0x0018 0x038 0x0000000C 0xF1090F28
0x00003011 0x04370000 0x09230000 0x001D40D8 0x00000100 0x001B00D8
0x00360288 0x003A81D4 0x0075057C 0x0287D1F4 0x0647D17C 0x0407D12C
0x0096000A 0x032007EC 0x00000F7D 0x00020032 0x00000002 0x000001F4
0x025A07EC 0x02140ED3 0x00FFF000 0x00002002 0x0000040C 0x000A007F
0x00040810 0x00FBF40D 0x0000009E 0x00033D91 0x00007E65 0x00080000
0x1D87B200 0x1986B9C3 0x1555B182 0x1134A53F 0x0D33A0FD 0x0982ACBE
0x0641D086 0x03A11C55 0x01A08C2E 0x00703012 0x00000403 0x000012F6
0x000008C0 0x1D87B200 0x1986B9C3 0x1555B182 0x1134A53F 0x0D33A0FD
0x0982ACBE 0x0641D086 0x03A11C55 0x01A08C2E 0x00703012 0x00000403

// hdr: gra_ctrl l8
0x29 0x01 0x00 0x09 0x0028 0x007 0x0000000C 0xF1091000
0x050140C8 0x28140802 0x00080190 0x00042233 0x07AA0FA0

// hdr: tl_ctrl l8
0x29 0x01 0x00 0x09 0x0038 0x04A 0x0000000C 0xF1091014
0x1E77C1FA 0x1CC755DE 0x1B06E9C3 0x195679A7 0x17B60D8C 0x1605A572
0x14653D57 0x12D4D53E 0x11447124 0x0FC4110C 0x0E43B0F4 0x0CE354DD
0x0B82FCC6 0x0A32A8B1 0x0902589D 0x07D20C89 0x06C1C477 0x05B18066
0x04C14456 0x03E10C47 0x0320D83A 0x0260A82E 0x01D08023 0x01405C1A
0x00D03C12 0x0070240B 0x00301406 0x00100402 0x00000000 0x00000000
0x1C3755E7 0x18C679B0 0x1575A57B 0x1244D546 0x0F441114 0x0C6354E4
0x09D2A8B8 0x07720C90 0x0561806C 0x03A10C4C 0x0230A832 0x01205C1D
0x0060240D 0x00000403 0x00000000 0x00000000 0x00000000 0x00000000
0x00000000 0x00000000 0x00000000 0x00000000 0x00000000 0x00000000
0x00000000 0x00000000 0x00000000 0x00000000 0x00000000 0x00000400
0x00000400 0x0003EFBF 0x0003EFBE 0x0003DF7D 0x0000003C 0x00038EFF
0x00028BF2 0x0001E926 0x00000017 0x00000000 0x00000000 0x5A2DB058

// hdr: tm_ctrl l8
0x29 0x01 0x00 0x09 0x0048 0x035 0x0000000C 0xF1091134
0x01290000 0x0246018D 0x03980309 0x04CC040D 0x06670568 0x07EC0738
0x07EC07EC 0x000007EC 0x01290000 0x0246018D 0x03980309 0x04CC040D
0x06670568 0x07EC0738 0x07EC07EC 0x000007EC 0x032003E8 0x0032012C
0x00280028 0x00280028 0x00280028 0x00280028 0x00280028 0x040A0A02
0x10101000 0x10101010 0x00001010 0x0FFF0FFF 0x0080000C 0x07EC1A02
0x00000000 0x000001A8 0x00001001 0x00000000 0x00000000 0x00000000
0x00000000 0x00000000 0x00000000 0x00000000 0x00000000 0x00000000
0x00000000 0x00000000 0x00000000 0x00140100 0x00000002 0x00000883
0x00000080 0x0000021C 0x0100021C

// hdr: ratio_ctrl l8
0x29 0x01 0x00 0x09 0x0068 0x005 0x0000000C 0xF1091244
0x00001000 0x00001000 0x00000100

// hdr: col_ctrl l8
0x29 0x01 0x00 0x09 0x0078 0x00A 0x0000000C 0xF1091250
0x0000194D 0x00140678 0x00140763 0x00000CCC 0x00000CCC 0x00808080
0x00080000 0x00080000

// hdr: csc_ctrl l8
0x29 0x01 0x00 0x09 0x0098 0x04D 0x0000000C 0xF1091270
0x00000E38 0x00001278 0x00000C18 0x00001058 0x00000E38 0x00000E3C
0x00000D9B 0x00002DC6 0x0000049F 0x0000F8AB 0x0000E755 0x00002000
0x00002000 0x0000E2EF 0x0000FD11 0x00000000 0x00000000 0x00000000
0x0001A649 0x00016E2A 0x0000B8CF 0x0000D9BE 0x0002DC55 0x000049EC
0x000013CB 0x00007A0E 0x0003CD58 0x00000000 0x00000000 0x00000000
0x00000D9B 0x00002DC6 0x0000049F 0x000FF8AB 0x000FE755 0x00002000
0x00002000 0x000FE2EF 0x000FFD11 0x00000000 0x00002000 0x00002000
0x0000A09F 0x0000544C 0x00000B14 0x000011B0 0x0000EB68 0x000002E5
0x00000433 0x0000168A 0x0000E543 0x00000000 0x00000000 0x00000000
0x00004000 0x00000000 0x00000000 0x00000000 0x00004000 0x00000000
0x00000000 0x00000000 0x00004000 0x00004000 0x00000000 0x000064C9
0x00004000 0x0000F403 0x0000E20A 0x00004000 0x000076C2 0x00000000
0x00000000 0x00000000 0x00000000

// hdr: lut_ctrl l8
0x29 0x01 0x00 0x09 0x00A8 0x008 0x0000000C 0xF109139C
0x000000A8 0x000000A8 0x00000090 0x00000090 0x000000A8 0x00000090

// hdr: scurve_ctrl l8
0x29 0x01 0x00 0x09 0x00B8 0x00B 0x0000000C 0xF10913B4
0x00000000 0x00000000 0x00000040 0x0012C10E 0x000003E8 0x00200080
0x0000012C 0x00008000 0x00000000

// hdr: de_ctrl l8
0x29 0x01 0x00 0x09 0x00C8 0x020 0x0000000C 0xF10913D8
0x00040000 0x00805040 0x00008080 0x0000012A 0x000001D6 0x00000309
0x000007EC 0x00000FFF 0x00204080 0x00000010 0x00000062 0x000000DF
0x0000012A 0x0000018D 0x00000246 0x00064168 0x00801201 0x02E70C0C
0x001021C0 0x000000FF 0x0FFF4000 0x00004002 0x0FFF0FFF 0x20F7E12A
0x100FFC1E 0x08011850 0x01A80100 0x00080200 0x0066640A 0x0033320A

// hdr: top_ctrl l9
0x29 0x01 0x00 0x09 0x0009 0x00E 0x0000000C 0xF1090EF8
0x00107AB5 0x00064194 0x00000D7F 0x09240438 0x00000800 0x00000000
0x00000000 0x00000020 0x00200020 0x00000020 0x00000020 0x00000020

// hdr: lce_ctrl l9
0x29 0x01 0x00 0x09 0x0019 0x038 0x0000000C 0xF1090F28
0x00003011 0x04370000 0x09230000 0x001D40D8 0x00000100 0x001B00D8
0x00360288 0x003A81D4 0x0075057C 0x0287D1F4 0x0647D17C 0x0407D12C
0x0096000A 0x032007EC 0x00000F7D 0x00020032 0x00000002 0x000001F4
0x025A07EC 0x02140ED3 0x00FFF000 0x00002002 0x0000040C 0x000A007F
0x00040810 0x00FBF40D 0x0000009E 0x00033D91 0x00007E65 0x00080000
0x1D87B200 0x1986B9C3 0x1555B182 0x1134A53F 0x0D33A0FD 0x0982ACBE
0x0641D086 0x03A11C55 0x01A08C2E 0x00703012 0x00000403 0x000012F6
0x000008C0 0x1D87B200 0x1986B9C3 0x1555B182 0x1134A53F 0x0D33A0FD
0x0982ACBE 0x0641D086 0x03A11C55 0x01A08C2E 0x00703012 0x00000403

// hdr: gra_ctrl l9
0x29 0x01 0x00 0x09 0x0029 0x007 0x0000000C 0xF1091000
0x050140C8 0x28140802 0x00080190 0x00042233 0x07AA0FA0

// hdr: tl_ctrl l9
0x29 0x01 0x00 0x09 0x0039 0x04A 0x0000000C 0xF1091014
0x1E77C1FA 0x1CC755DE 0x1B06E9C3 0x195679A7 0x17B60D8C 0x1605A572
0x14653D57 0x12D4D53E 0x11447124 0x0FC4110C 0x0E43B0F4 0x0CE354DD
0x0B82FCC6 0x0A32A8B1 0x0902589D 0x07D20C89 0x06C1C477 0x05B18066
0x04C14456 0x03E10C47 0x0320D83A 0x0260A82E 0x01D08023 0x01405C1A
0x00D03C12 0x0070240B 0x00301406 0x00100402 0x00000000 0x00000000
0x1C3755E7 0x18C679B0 0x1575A57B 0x1244D546 0x0F441114 0x0C6354E4
0x09D2A8B8 0x07720C90 0x0561806C 0x03A10C4C 0x0230A832 0x01205C1D
0x0060240D 0x00000403 0x00000000 0x00000000 0x00000000 0x00000000
0x00000000 0x00000000 0x00000000 0x00000000 0x00000000 0x00000000
0x00000000 0x00000000 0x00000000 0x00000000 0x00000000 0x00000400
0x00000400 0x0003EFBF 0x0003EFBE 0x0003DF7D 0x0000003C 0x00038EFF
0x00028BF2 0x0001E926 0x00000017 0x00000000 0x00000000 0x5A2DB058

// hdr: tm_ctrl l9
0x29 0x01 0x00 0x09 0x0049 0x035 0x0000000C 0xF1091134
0x01290000 0x0246018D 0x03980309 0x04CC040D 0x06670568 0x07EC0738
0x07EC07EC 0x000007EC 0x01290000 0x0246018D 0x03980309 0x04CC040D
0x06670568 0x07EC0738 0x07EC07EC 0x000007EC 0x032003E8 0x0032012C
0x00280028 0x00280028 0x00280028 0x00280028 0x00280028 0x040A0A02
0x10101000 0x10101010 0x00001010 0x0FFF0FFF 0x0080000C 0x07EC1A02
0x00000000 0x000001A8 0x00001001 0x00000000 0x00000000 0x00000000
0x00000000 0x00000000 0x00000000 0x00000000 0x00000000 0x00000000
0x00000000 0x00000000 0x00000000 0x00140100 0x00000002 0x00000883
0x00000080 0x0000021C 0x0100021C

// hdr: ratio_ctrl l9
0x29 0x01 0x00 0x09 0x0069 0x005 0x0000000C 0xF1091244
0x00001000 0x00001000 0x00000100

// hdr: col_ctrl l9
0x29 0x01 0x00 0x09 0x0079 0x00A 0x0000000C 0xF1091250
0x0000194D 0x00140678 0x00140763 0x00000CCC 0x00000CCC 0x00808080
0x00080000 0x00080000

// hdr: csc_ctrl l9
0x29 0x01 0x00 0x09 0x0099 0x04D 0x0000000C 0xF1091270
0x00000E38 0x00001278 0x00000C18 0x00001058 0x00000E38 0x00000E3C
0x00000D9B 0x00002DC6 0x0000049F 0x0000F8AB 0x0000E755 0x00002000
0x00002000 0x0000E2EF 0x0000FD11 0x00000000 0x00000000 0x00000000
0x0001A649 0x00016E2A 0x0000B8CF 0x0000D9BE 0x0002DC55 0x000049EC
0x000013CB 0x00007A0E 0x0003CD58 0x00000000 0x00000000 0x00000000
0x00000D9B 0x00002DC6 0x0000049F 0x000FF8AB 0x000FE755 0x00002000
0x00002000 0x000FE2EF 0x000FFD11 0x00000000 0x00002000 0x00002000
0x0000A09F 0x0000544C 0x00000B14 0x000011B0 0x0000EB68 0x000002E5
0x00000433 0x0000168A 0x0000E543 0x00000000 0x00000000 0x00000000
0x00004000 0x00000000 0x00000000 0x00000000 0x00004000 0x00000000
0x00000000 0x00000000 0x00004000 0x00004000 0x00000000 0x000064C9
0x00004000 0x0000F403 0x0000E20A 0x00004000 0x000076C2 0x00000000
0x00000000 0x00000000 0x00000000

// hdr: lut_ctrl l9
0x29 0x01 0x00 0x09 0x00A9 0x008 0x0000000C 0xF109139C
0x000000A8 0x000000A8 0x00000090 0x00000090 0x000000A8 0x00000090

// hdr: scurve_ctrl l9
0x29 0x01 0x00 0x09 0x00B9 0x00B 0x0000000C 0xF10913B4
0x00000000 0x00000000 0x00000040 0x0012C10E 0x000003E8 0x00200080
0x0000012C 0x00008000 0x00000000

// hdr: de_ctrl l9
0x29 0x01 0x00 0x09 0x00C9 0x020 0x0000000C 0xF10913D8
0x00040000 0x00805040 0x00008080 0x0000012A 0x000001D6 0x00000309
0x000007EC 0x00000FFF 0x00204080 0x00000010 0x00000062 0x000000DF
0x0000012A 0x0000018D 0x00000246 0x00064168 0x00801201 0x02E70C0C
0x001021C0 0x000000FF 0x0FFF4000 0x00004002 0x0FFF0FFF 0x20F7E12A
0x100FFC1E 0x08011850 0x01A80100 0x00080200 0x0066640A 0x0033320A

// hdr: top_ctrl l14
0x29 0x01 0x00 0x09 0x000E 0x00E 0x0000000C 0xF1090EF8
0x00107AB5 0x000751D4 0x00000D7F 0x09240438 0x00000800 0x00000000
0x00000000 0x00000020 0x00200020 0x00000020 0x00000020 0x00000020

// hdr: lce_ctrl l14
0x29 0x01 0x00 0x09 0x001E 0x038 0x0000000C 0xF1090F28
0x00003011 0x04370000 0x09230000 0x001D40D8 0x00000100 0x001B00D8
0x00360288 0x003A81D4 0x0075057C 0x014C0100 0x0647097C 0x040C0200
0x50501E32 0x014007EC 0x05A00F7D 0x00020032 0x00000032 0x00000190
0x025A07EC 0x02140ED3 0x00FFF000 0x00002002 0x0000040C 0x000A007F
0x00040810 0x00FBF40D 0x0000009E 0x00033D91 0x00007E65 0x00080000
0x1D87B200 0x1986B9C3 0x1555B182 0x1134A53F 0x0D33A0FD 0x0982ACBE
0x0641D086 0x03A11C55 0x01A08C2E 0x00703012 0x00000403 0x000012F6
0x000008C0 0x1D87B200 0x1986B9C3 0x1555B182 0x1134A53F 0x0D33A0FD
0x0982ACBE 0x0641D086 0x03A11C55 0x01A08C2E 0x00703012 0x00000403

// hdr: gra_ctrl l14
0x29 0x01 0x00 0x09 0x002E 0x007 0x0000000C 0xF1091000
0x050140C8 0x28140802 0x00080190 0x00042233 0x07AA0FA0

// hdr: tl_ctrl l14
0x29 0x01 0x00 0x09 0x003E 0x04A 0x0000000C 0xF1091014
0x1E77C1FA 0x1CC755DE 0x1B06E9C3 0x195679A7 0x17B60D8C 0x1605A572
0x14653D57 0x12D4D53E 0x11447124 0x0FC4110C 0x0E43B0F4 0x0CE354DD
0x0B82FCC6 0x0A32A8B1 0x0902589D 0x07D20C89 0x06C1C477 0x05B18066
0x04C14456 0x03E10C47 0x0320D83A 0x0260A82E 0x01D08023 0x01405C1A
0x00D03C12 0x0070240B 0x00301406 0x00100402 0x00000000 0x00000000
0x1C3755E7 0x18C679B0 0x1575A57B 0x1244D546 0x0F441114 0x0C6354E4
0x09D2A8B8 0x07720C90 0x0561806C 0x03A10C4C 0x0230A832 0x01205C1D
0x0060240D 0x00000403 0x00000000 0x00000000 0x00000000 0x00000000
0x00000000 0x00000000 0x00000000 0x00000000 0x00000000 0x00000000
0x00000000 0x00000000 0x00000000 0x00000000 0x00000000 0x00000500
0x00000400 0x0003EFBF 0x0003EFBE 0x0003DF7D 0x0000003C 0x00038EFF
0x00028BF2 0x0001E926 0x00000017 0x00000000 0x00000000 0x5A2DB058

// hdr: tm_ctrl l14
0x29 0x01 0x00 0x09 0x004E 0x035 0x0000000C 0xF1091134
0x01290000 0x0246018D 0x03980309 0x04CC040D 0x06670568 0x07EC0738
0x07EC07EC 0x000007EC 0x01290000 0x0246018D 0x03980309 0x04CC040D
0x06670568 0x07EC0738 0x07EC07EC 0x000007EC 0x032003E8 0x0032012C
0x00280028 0x00280028 0x00280028 0x00280028 0x00280028 0x040A0A02
0x10101000 0x10101010 0x00001010 0x0FFF0FFF 0x0080000C 0x07EC1A02
0x00000000 0x000001A8 0x00001001 0x00000000 0x00000000 0x00000000
0x00000000 0x00000000 0x00000000 0x00000000 0x00000000 0x00000000
0x00000000 0x00000000 0x00000000 0x00140100 0x00000002 0x00000883
0x00000080 0x0000021C 0x0100021C

// hdr: ratio_ctrl l14
0x29 0x01 0x00 0x09 0x006E 0x005 0x0000000C 0xF1091244
0x00001000 0x00001000 0x00000100

// hdr: col_ctrl l14
0x29 0x01 0x00 0x09 0x007E 0x00A 0x0000000C 0xF1091250
0x0000194D 0x00140678 0x00140763 0x00000CCC 0x00000CCC 0x00808080
0x00080000 0x00080000

// hdr: csc_ctrl l14
0x29 0x01 0x00 0x09 0x009E 0x04D 0x0000000C 0xF1091270
0x00000E38 0x00001278 0x00000C18 0x00001058 0x00000E38 0x00000E3C
0x00000D9B 0x00002DC6 0x0000049F 0x0000F8AB 0x0000E755 0x00002000
0x00002000 0x0000E2EF 0x0000FD11 0x00000000 0x00000000 0x00000000
0x0001A649 0x00016E2A 0x0000B8CF 0x0000D9BE 0x0002DC55 0x000049EC
0x000013CB 0x00007A0E 0x0003CD58 0x00000000 0x00000000 0x00000000
0x00000D9B 0x00002DC6 0x0000049F 0x000FF8AB 0x000FE755 0x00002000
0x00002000 0x000FE2EF 0x000FFD11 0x00000000 0x00002000 0x00002000
0x0000A09F 0x0000544C 0x00000B14 0x000011B0 0x0000EB68 0x000002E5
0x00000433 0x0000168A 0x0000E543 0x00000000 0x00000000 0x00000000
0x00004000 0x00000000 0x00000000 0x00000000 0x00004000 0x00000000
0x00000000 0x00000000 0x00004000 0x00004000 0x00000000 0x000064C9
0x00004000 0x0000F403 0x0000E20A 0x00004000 0x000076C2 0x00000000
0x00000000 0x00000000 0x00000000

// hdr: lut_ctrl l14
0x29 0x01 0x00 0x09 0x00AE 0x008 0x0000000C 0xF109139C
0x000000A8 0x000000A8 0x00000090 0x00000090 0x000000A8 0x00000090

// hdr: scurve_ctrl l14
0x29 0x01 0x00 0x09 0x00BE 0x00B 0x0000000C 0xF10913B4
0x00000000 0x00000000 0x00000040 0x001180E6 0x000003E8 0x00200080
0x0000012C 0x00008000 0x00000000

// hdr: de_ctrl l14
0x29 0x01 0x00 0x09 0x00CE 0x020 0x0000000C 0xF10913D8
0x00040000 0x00464646 0x00004646 0x0000012A 0x000001D6 0x00000309
0x000007EC 0x00000FFF 0x00204080 0x00000010 0x00000062 0x000000DF
0x0000012A 0x0000018D 0x00000246 0x000500F0 0x00801201 0x01BB0C0C
0x001021C0 0x000000FF 0x0FFF4000 0x00004002 0x0FFF0FFF 0x10F7E12A
0x100FFC1E 0x08011850 0x01A80100 0x00080200 0x0066640A 0x0033320A

// hdr: top_ctrl l15
0x29 0x01 0x00 0x09 0x000F 0x00E 0x0000000C 0xF1090EF8
0x00107AB5 0x000653D4 0x00000D3F 0x09240438 0x00000800 0x00000000
0x00000000 0x00000020 0x00200020 0x00000020 0x00000020 0x00000020

// hdr: lce_ctrl l15
0x29 0x01 0x00 0x09 0x001F 0x038 0x0000000C 0xF1090F28
0x00003001 0x04370000 0x09230000 0x001D40D8 0x00000100 0x001B00D8
0x00360288 0x003A81D4 0x0075057C 0x028320C8 0x0467D17C 0x0197D12C
0x00963232 0x0C800961 0x000013CA 0x00020014 0x00000002 0x000003FF
0x02140F7D 0x020A0000 0x00FFF000 0x00002002 0x0000040C 0x000A007F
0x00040810 0x00FDF309 0x0000009E 0x00033D91 0x0000A8B0 0x00100000
0x1D87B200 0x1986B9C3 0x1555B182 0x1134A53F 0x0D33A0FD 0x0982ACBE
0x0641D086 0x03A11C55 0x01A08C2E 0x00703012 0x00000403 0x000012F6
0x000008C0 0x1D87B200 0x1986B9C3 0x1555B182 0x1134A53F 0x0D33A0FD
0x0982ACBE 0x0641D086 0x03A11C55 0x01A08C2E 0x00703012 0x00000403

// hdr: gra_ctrl l15
0x29 0x01 0x00 0x09 0x002F 0x007 0x0000000C 0xF1091000
0x05014FFF 0x28140802 0x00080190 0x00042233 0x07AA0FA0

// hdr: tl_ctrl l15
0x29 0x01 0x00 0x09 0x003F 0x04A 0x0000000C 0xF1091014
0x1E77C1FA 0x1CC755DE 0x1B06E9C3 0x195679A7 0x17B60D8C 0x1605A572
0x14653D57 0x12D4D53E 0x11447124 0x0FC4110C 0x0E43B0F4 0x0CE354DD
0x0B82FCC6 0x0A32A8B1 0x0902589D 0x07D20C89 0x06C1C477 0x05B18066
0x04C14456 0x03E10C47 0x0320D83A 0x0260A82E 0x01D08023 0x01405C1A
0x00D03C12 0x0070240B 0x00301406 0x00100402 0x00000000 0x00000000
0x1C3755E7 0x18C679B0 0x1575A57B 0x1244D546 0x0F441114 0x0C6354E4
0x09D2A8B8 0x07720C90 0x0561806C 0x03A10C4C 0x0230A832 0x01205C1D
0x0060240D 0x00000403 0x00000000 0x00000000 0x00000000 0x00000000
0x00000000 0x00000000 0x00000000 0x00000000 0x00000000 0x00000000
0x00000000 0x00000000 0x00000000 0x00000000 0x00000000 0x00000400
0x00000400 0x0003EFBF 0x0003EFBE 0x0003DF7D 0x0000003C 0x00038EFF
0x00028BF2 0x0001E926 0x00000017 0x00000000 0x00000000 0x5A2DB058

// hdr: tm_ctrl l15
0x29 0x01 0x00 0x09 0x004F 0x035 0x0000000C 0xF1091134
0x01290000 0x0246018D 0x03980309 0x04CC040D 0x06670568 0x07EC0738
0x07EC07EC 0x000007EC 0x01290000 0x0246018D 0x03980309 0x04CC040D
0x06670568 0x07EC0738 0x07EC07EC 0x000007EC 0x032003E8 0x0032012C
0x00280028 0x00280028 0x00280028 0x00280028 0x00280028 0x040A0A02
0x10101000 0x10101010 0x00001010 0x0FFF0FFF 0x0080000C 0x07EC1A02
0x00000000 0x000001A8 0x00001001 0x00000000 0x00000000 0x00000000
0x00000000 0x00000000 0x00000000 0x00000000 0x00000000 0x00000000
0x00000000 0x00000000 0x00000000 0x00140100 0x00000002 0x00000883
0x00000080 0x0000021C 0x0100021C

// hdr: ratio_ctrl l15
0x29 0x01 0x00 0x09 0x006F 0x005 0x0000000C 0xF1091244
0x00001000 0x00001000 0x00000100

// hdr: col_ctrl l15
0x29 0x01 0x00 0x09 0x007F 0x00A 0x0000000C 0xF1091250
0x0000194D 0x00140678 0x00140763 0x00000CCC 0x00000CCC 0x00808080
0x00080000 0x00080000

// hdr: csc_ctrl l15
0x29 0x01 0x00 0x09 0x009F 0x04D 0x0000000C 0xF1091270
0x00000E38 0x00001278 0x00000C18 0x00001058 0x00000E38 0x00000E3C
0x00000D9B 0x00002DC6 0x0000049F 0x0000F8AB 0x0000E755 0x00002000
0x00002000 0x0000E2EF 0x0000FD11 0x00000000 0x00000000 0x00000000
0x0001A649 0x00016E2A 0x0000B8CF 0x0000D9BE 0x0002DC55 0x000049EC
0x000013CB 0x00007A0E 0x0003CD58 0x00000000 0x00000000 0x00000000
0x00000D9B 0x00002DC6 0x0000049F 0x000FF8AB 0x000FE755 0x00002000
0x00002000 0x000FE2EF 0x000FFD11 0x00000000 0x00002000 0x00002000
0x0000A09F 0x0000544C 0x00000B14 0x000011B0 0x0000EB68 0x000002E5
0x00000433 0x0000168A 0x0000E543 0x00000000 0x00000000 0x00000000
0x00004000 0x00000000 0x00000000 0x00000000 0x00004000 0x00000000
0x00000000 0x00000000 0x00004000 0x00004000 0x00000000 0x000064C9
0x00004000 0x0000F403 0x0000E20A 0x00004000 0x000076C2 0x00000000
0x00000000 0x00000000 0x00000000

// hdr: lut_ctrl l15
0x29 0x01 0x00 0x09 0x00AF 0x008 0x0000000C 0xF109139C
0x000000A8 0x000000A8 0x00000090 0x00000090 0x000000A8 0x00000090

// hdr: scurve_ctrl l15
0x29 0x01 0x00 0x09 0x00BF 0x00B 0x0000000C 0xF10913B4
0x00000000 0x00000000 0x00000040 0x00100100 0x00000190 0x00200080
0x0000012C 0x00008000 0x000003E8

// hdr: de_ctrl l15
0x29 0x01 0x00 0x09 0x00CF 0x020 0x0000000C 0xF10913D8
0x00040000 0x00645040 0x00008080 0x0000012A 0x0000018D 0x00000309
0x00000667 0x000007EC 0x00408080 0x00000020 0x0000001A 0x00000062
0x0000012A 0x0000018D 0x00000246 0x00050168 0x00801201 0x016B0C0C
0x001021C0 0x000000FF 0x0FFF2800 0x00004002 0x0FFF0FFF 0x1079512A
0x1003E81E 0x08012C50 0x01A80100 0x00080200 0x0066640A 0x0033320A

>;
};
};
};
