/* Copyright (C) 2017 Tcl Corporation Limited */
/* Copyright (c) 2013-2015, The Linux Foundation. All rights reserved.
 *
 * This program is free software; you can redistribute it and/or modify
 * it under the terms of the GNU General Public License version 2 and
 * only version 2 as published by the Free Software Foundation.
 *
 * This program is distributed in the hope that it will be useful,
 * but WITHOUT ANY WARRANTY; without even the implied warranty of
 * MERCHANTABILITY or FITNESS FOR A PARTICULAR PURPOSE.  See the
 * GNU General Public License for more details.
 */
&mdss_mdp {
	dsi_hx83112a_auo_1080_video: qcom,mdss_dsi_hx83112a_auo_1080p_video {
		qcom,mdss-dsi-panel-name = "hx83112a auo 1080p video mode dsi panel";
		qcom,mdss-dsi-panel-type = "dsi_video_mode";

		qcom,dsi-ctrl-num = <0>;
		qcom,dsi-phy-num = <0>;
		qcom,dsi-select-clocks = "mux_byte_clk0", "mux_pixel_clk0";
		qcom,mdss-dsi-virtual-channel-id = <0>;
		qcom,mdss-dsi-stream = <0>;
		qcom,mdss-dsi-h-left-border = <0>;
		qcom,mdss-dsi-h-right-border = <0>;
		qcom,mdss-dsi-v-top-border = <0>;
		qcom,mdss-dsi-v-bottom-border = <0>;
		qcom,mdss-dsi-bpp = <24>;
		qcom,mdss-dsi-color-order = "rgb_swap_rgb";
		qcom,mdss-dsi-underflow-color = <0xff>;
		qcom,mdss-dsi-border-color = <0>;
		qcom,mdss-dsi-h-sync-pulse = <1>;
		qcom,mdss-dsi-traffic-mode = "burst_mode";
		qcom,mdss-dsi-lane-map = "lane_map_0123";
		qcom,mdss-dsi-bllp-eof-power-mode;
		qcom,mdss-dsi-bllp-power-mode;
		qcom,mdss-dsi-tx-eot-append;
		qcom,mdss-dsi-lane-0-state;
		qcom,mdss-dsi-lane-1-state;
		qcom,mdss-dsi-lane-2-state;
		qcom,mdss-dsi-lane-3-state;

		qcom,mdss-dsi-lp11-init;
		qcom,mdss-dsi-init-delay-us = <50000>;
		qcom,mdss-dsi-bl-min-level = <1>;
		qcom,mdss-dsi-bl-max-level = <4095>;
		qcom,mdss-dsi-dma-trigger = "trigger_sw";
		qcom,mdss-dsi-mdp-trigger = "none";
		qcom,mdss-dsi-bl-pmic-control-type = "bl_ctrl_wled";
		qcom,mdss-dsi-reset-sequence = <1 20>, <0 20>, <1 50>;
		qcom,mdss-pan-physical-width-dimension = <65>;
		qcom,mdss-pan-physical-height-dimension = <115>;
		qcom,mdss-dsi-dma-schedule-line = <10>;
		qcom,mdss-dsi-panel-hdr-enabled; //for test
		qcom,mdss-dsi-panel-hdr-color-primaries = <15400 16350 33300 16650
			11250 35850 6950  2750>; //for test
		qcom,mdss-dsi-panel-peak-brightness = <3500000>; //for test
		qcom,mdss-dsi-panel-blackness-level = <350>; //for test

		qcom,mdss-dsi-display-timings {
			timing@0 {
				qcom,mdss-dsi-panel-width = <1080>;
				qcom,mdss-dsi-panel-height = <2340>;
				qcom,mdss-dsi-h-front-porch = <28>;
				qcom,mdss-dsi-h-back-porch = <8>;
				qcom,mdss-dsi-h-pulse-width = <8>;
				qcom,mdss-dsi-h-sync-skew = <0>;
				qcom,mdss-dsi-v-back-porch = <5>;
				qcom,mdss-dsi-v-front-porch = <27>;
				qcom,mdss-dsi-v-pulse-width = <5>;
				qcom,mdss-dsi-panel-framerate = <60>;
				qcom,mdss-dsi-on-command = [
						  39 01 00 00 00 00 04 B9 83 11 2A
						  39 01 00 00 00 00 09 B1 08 28 28 83 83 4C 4F
						     33
						  39 01 00 00 00 00 0F B2 00 02 00 90 24 00 08
						     19 EA 11 11 00 11 A3
						  39 01 00 00 00 00 1C B4 58 68 58 68 0F EF 0B
						     C0 0B C0 0B C0 00 FF 00 FF 00 00 14 15 00
						     29 11 07 12 00 29
						  39 01 00 00 00 00 02 BD 02
						  39 01 00 00 00 00 0A B4 00 12 12 11 88 12 12
						     00 53
						  39 01 00 00 00 00 02 BD 00
						  39 01 00 00 00 00 02 BD 03
						  39 01 00 00 00 00 3A C1 FF FE FB F8 F4 F1 ED
						     E6 E2 DE DB D6 D3 CF CA C6 C2 BE B9 B0 A7
						     9E 96 8D 84 7C 74 6B 62 5A 51 49 41 39 31
						     29 21 19 12 0A 06 05 02 01 00 00 C9 B3 08
						     0E F2 E1 59 F4 22 AD 40
						  39 01 00 00 00 00 02 BD 02
						  39 01 00 00 00 00 3A C1 FF FE FB F8 F4 F1 ED
						     E6 E2 DE DB D6 D3 CF CA C6 C2 BE B9 B0 A7
						     9E 96 8D 84 7C 74 6B 62 5A 51 49 41 39 31
						     29 21 19 12 0A 06 05 02 01 00 00 C9 B3 08
						     0E F2 E1 59 F4 22 AD 40
						  39 01 00 00 00 00 02 BD 01
						  39 01 00 00 00 00 3A C1 FF FE FB F8 F4 F1 ED
						     E6 E2 DE DB D6 D3 CF CA C6 C2 BE B9 B0 A7
						     9E 96 8D 84 7C 74 6B 62 5A 51 49 41 39 31
						     29 21 19 12 0A 06 05 02 01 00 00 C9 B3 08
						     0E F2 E1 59 F4 22 AD 40
						  39 01 00 00 00 00 02 BD 00
						  39 01 00 00 00 00 02 C1 01
						  39 01 00 00 00 00 07 C7 70 00 04 E0 33 00
						  39 01 00 00 00 00 02 CC 08
						  39 01 00 00 00 00 03 D2 2B 2B
						  39 01 00 00 00 00 32 D3 80 00 00 00 00 01 00
						     08 08 03 03 22 18 07 07 07 07 32 10 06 00
						     06 32 10 07 00 07 32 19 31 09 31 00 00 05
						     00 00 00 00 08 09 30 00 00 00 06 0D 00 0F
						  39 01 00 00 00 00 02 BD 01
						  39 01 00 00 00 00 09 D3 00 00 19 10 00 0A 00
						     81
						  39 01 00 00 00 00 02 BD 00
						  39 01 00 00 00 00 31 D5 18 18 18 18 18 18 18
						     18 C0 C0 18 18 19 19 18 18 40 40 18 18 18
						     18 3F 3F 28 28 24 24 02 03 02 03 00 01 00
						     01 31 31 31 31 30 30 30 30 2F 2F 2F 2F
						  39 01 00 00 00 00 31 D6 18 18 18 18 18 18 18
						     18 40 40 18 18 18 18 19 19 40 40 18 18 18
						     18 3F 3F 24 24 28 28 01 00 01 00 03 02 03
						     02 31 31 31 31 30 30 30 30 2F 2F 2F 2F
						  39 01 00 00 00 00 19 D8 AA EA AA AA AA AA AA
						     EA AA AA AA AA AA EA AB AA AA AA AA EA AB
						     AA AA AA
						  39 01 00 00 00 00 02 BD 01
						  39 01 00 00 00 00 19 D8 AA 2E 28 00 00 00 AA
						     2E 28 00 00 00 AA EE AA AA AA AA AA EE AA
						     AA AA AA
						  39 01 00 00 00 00 02 BD 02
						  39 01 00 00 00 00 0D D8 AA FF FF FF FF FF AA
						     FF FF FF FF FF
						  39 01 00 00 00 00 02 BD 03
						  39 01 00 00 00 00 19 D8 AA AA EA AA AA AA AA
						     AA EA AA AA AA AA FF FF FF FF FF AA FF FF
						     FF FF FF
						  39 01 00 00 00 00 02 BD 00
						  39 01 00 00 00 00 18 E7 0E 0E 1E 65 1C 65 00
						     50 20 20 00 00 02 02 02 05 14 14 32 B9 23
						     B9 08
						  39 01 00 00 00 00 02 BD 01
						  39 01 00 00 00 00 09 E7 02 00 A8 01 A8 0D A4
						     0E
						  39 01 00 00 00 00 02 BD 02
						  39 01 00 00 00 00 1E E7 00 00 08 00 01 00 00
						     00 00 00 00 00 00 00 00 00 00 00 00 00 00
						     00 04 00 00 00 00 02 00
						  39 01 00 00 00 00 02 BD 00
						  39 01 00 00 00 00 02 E9 C3
						  39 01 00 00 00 00 03 CB D1 D6
						  39 01 00 00 00 00 02 E9 3F
						  39 01 00 00 00 00 02 E9 C6
						  39 01 00 00 00 00 02 BF 37
						  39 01 00 00 00 00 02 E9 3F
						  05 01 00 00 96 00 02 11 00
						  05 01 00 00 32 00 02 29 00];

				qcom,mdss-dsi-off-command = [05 01 00 00 14 00 02 28 00
							05 01 00 00 78 00 02 10 00];
				qcom,mdss-dsi-on-command-state = "dsi_lp_mode";
				qcom,mdss-dsi-off-command-state = "dsi_hs_mode";
			};
		};
	};
};
